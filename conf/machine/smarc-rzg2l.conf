## meta-rz-bsp/conf/machine/smarc-rzg2ul.conf
```bitbake
#@TYPE: Machine
#@NAME: smarc-rzg2ul machine
#@DESCRIPTION: RZ/G2UL SMARC platform

require conf/machine/include/arm/armv8-2a/tune-cortexa55.inc
require conf/machine/include/rz-common.inc
require conf/machine/include/rzg2l-family.inc

# Trusted Firmware-A configuration
PREFERRED_VERSION_trusted-firmware-a ?= "2.9%"
TFA_PLATFORM ?= "g2ul"
TFA_BOARD ?= "g2ul_smarc SOC_TYPE=1 SPI_FLASH=AT25QL128A"
TFA_UBOOT ?= "1"
TFA_BUILD_TARGET ?= "bl2 bl31 fip"
BL2_BOOT_TARGET ?= "spi mmc esd"
BL2_ADJUST_VMA ?= "0x00011E00"
FIP_ADJUST_VMA ?= "0x0000"

# U-Boot Configuration
UBOOT_CONFIG ??= "smarc-rzg2ul"
UBOOT_CONFIG[smarc-rzg2ul] = "smarc-rzg2ul_defconfig"
PREFERRED_VERSION_u-boot = "2021.10%"

# Flash Writer configuration
FLASH_WRITER_BOARD ?= "RZG2UL_SMARC"

# Wic image
WKS_FILE = "rz-image-bootpart-esd.wks"

IMAGE_BOOT_FILES = " \
	bl2_bp_spi-${MACHINE}.bin \
	bl2_bp_mmc-${MACHINE}.bin \
	fip-${MACHINE}.bin \
	bl2_bp_spi-${MACHINE}.srec \
	bl2_bp_mmc-${MACHINE}.srec \
	fip-${MACHINE}.srec \
	Flash_Writer_SCIF_RZG2UL_SMARC_DDR4_1GB_1PCS.mot \
"
do_image_wic[depends] += "firmware-pack:do_deploy flash-writer:do_deploy"
```

## meta-rz-bsp/conf/machine/smarc-rzg3e.conf
```bitbake
#@TYPE: Machine
#@NAME: smarc-rzg3e
#@DESCRIPTION: Reference machine configuration for the RZ/G3E SMARC EVK

require conf/machine/include/arm/armv8-2a/tune-cortexa55.inc
require conf/machine/include/rz-common.inc
require conf/machine/include/rzg3e-family.inc

# Machine configuration
MACHINE_FEATURES:append = " alsa ext2 pci serial usbgadget usbhost can"

# Trusted Firmware-A configuration
PREFERRED_VERSION_trusted-firmware-a ?= "2.10%"
TFA_PLATFORM ?= "g3e"
TFA_BOARD ?= "smarc"
TFA_UBOOT ?= "1"
TFA_BUILD_TARGET ?= "bl2 fip"
BL2_BOOT_TARGET ?= "spi mmc esd"
BL2_ADJUST_VMA ?= "0x08003600"
FIP_ADJUST_VMA ?= "0x0000"
EXTRA_IMAGEDEPENDS += " firmware-pack"

# U-Boot Configuration
UBOOT_CONFIG ??= "smarc-rzg3e"
UBOOT_CONFIG[smarc-rzg3e] = "smarc-rzg3e_defconfig"
PREFERRED_VERSION_u-boot = "2023.10%"

# Linux kernel configuration
KERNEL_IMAGETYPE ?= "Image"
KERNEL_DEVICETREE ?= "renesas/r9a09g047e54-smarc.dtb"

IMAGE_BOOT_FILES = " \
	bl2_bp_spi-${MACHINE}.bin \
	bl2_bp_spi-${MACHINE}.srec \
	bl2_bp_mmc-${MACHINE}.bin \
	bl2_bp_mmc-${MACHINE}.srec \
	fip-${MACHINE}.bin \
	fip-${MACHINE}.srec \
"
do_image_wic[depends] += "firmware-pack:do_deploy"
```

## meta-rz-bsp/wic/rz-image-bootpart-mmc.wks
```
# Short-description: Create image for eMMC
# Long-description: Creates a image that can be used to write to eMMC for RZ boards
#                   First partition contains files of bootloader and related components
#                   Second partition contains rootfs, as well as Linux image and devicetree
#                   Note: the bootloader in first partition cannot be used for eMMC boot. In eMMC boot
#                         user has to manually write the bootloader to mmcblk0boot0.

part --source bootimg-partition --fstype=vfat --label bootloader --align 1024
part --source rootfs            --fstype=ext4 --label root       --align 4
```

## meta-rz-common/conf/layer.conf
```bitbake
# We have a conf and classes directory, add to BBPATH
BBPATH .= ":${LAYERDIR}"

# We have recipes-* directories, add to BBFILES
BBFILES += "${LAYERDIR}/recipes-*/*/*.bb \
	    ${LAYERDIR}/recipes-*/*/*.bbappend"

BBFILES_DYNAMIC += " \
    qt5-layer:${LAYERDIR}/dynamic-layers/qt5-layer/*/*.bb \
    qt5-layer:${LAYERDIR}/dynamic-layers/qt5-layer/*/*.bbappend \
    virtualization-layer:${LAYERDIR}/dynamic-layers/virtualization-layer/*/*.bb \
    virtualization-layer:${LAYERDIR}/dynamic-layers/virtualization-layer/*/*.bbappend \
"

BBMASK_append = " qtwebengine "

# We have recipes-debian sub-directories that contained CIP-Core packages, add to BBFILES based on config CIP_MODE
CIPDIR = "${LAYERDIR}/recipes-debian"
BBFILES += "${@'${CIPDIR}/buster/*/*.bb	${CIPDIR}/buster/*/*.bbappend' if ('${CIP_MODE}' == 'Buster') else ' '}"
BBFILES += "${@'${CIPDIR}/bullseye/*/*.bb ${CIPDIR}/bullseye/*/*.bbappend' if ('${CIP_MODE}' == 'Bullseye') else ' '}"

BBFILE_COLLECTIONS += "rz-common"
BBFILE_PATTERN_rz-common = "^${LAYERDIR}/"
BBFILE_PRIORITY_rz-common = "15"

LAYERDEPENDS_rz-common = "core yocto yoctobsp openembedded-layer meta-python"
LAYERSERIES_COMPAT_rz-common = "dunfell"

HOSTTOOLS += "xz"

SPDXLICENSEMAP[LGPLv2.0+] = "LGPL-2.0-or-later"
SPDXLICENSEMAP[GPL-2+] = "GPL-2.0-or-later"
```

## meta-rz-common/conf/machine/include/rzg1-common.inc
```bitbake
require conf/machine/include/${SOC_FAMILY}.inc
# Configuration for kernel
PREFERRED_PROVIDER_virtual/kernel = "linux-renesas"

MACHINE_FEATURES = ""

KERNEL_IMAGETYPE = "uImage"
KERNEL_EXTRA_ARGS += "LOADADDR=0x40008000"

IMAGE_FSTYPES_append = " tar.bz2 ext4"

# libdrm
PREFERRED_VERSION_libdrm = "2.4.83"

# Add variable to Build Configuration in build log
BUILDCFG_VARS_append = " SOC_FAMILY"

#add u-boot
PREFERRED_VERSION_u-boot = "v2013.01%"
```

## meta-rz-common/wic/rz-image-bootpart-esd.wks
```
# Short-description: Create SD card image for eSD boot
# Long-description: Creates a SD card image that can be used to boot up RZ boards.
#                   First area (unformatted) contains bootloader
#                   Second area (first partition) contains files of bootloader and related components
#                   Last area (second partition) contains rootfs, as well as Linux image and devicetree
#                   Note: for eSD boot, SD card must be mmc0. If not use eSD boot mode, on the boards
#                         with multiple SD card slots, SD card can be either mmc0 or mmc1.

part --source rawcopy --sourceparams="file=bl2_bp_esd-${MACHINE}.bin" --no-table
part --source rawcopy --sourceparams="file=bl2-${MACHINE}.bin" --no-table --align 4
part --source rawcopy --sourceparams="file=fip-${MACHINE}.bin" --no-table  --align 64

part --source bootimg-partition --fstype=vfat --label bootloaderfiles --align 1024
part --source rootfs            --fstype=ext4 --label root            --align 4
```

## meta-rz-common/wic/rz-image-bootpart-mmc.wks
```
# Short-description: Create image for eMMC
# Long-description: Creates a image that can be used to write to eMMC for RZ boards
#                   First partition contains files of bootloader and related components
#                   Second partition contains rootfs, as well as Linux image and devicetree
#                   Note: the bootloader in first partition cannot be used for eMMC boot. In eMMC boot
#                         user has to manually write the bootloader to mmcblk0boot0.


part --source bootimg-partition --fstype=vfat --label bootloaderfiles --align 1024 --fixed-size 512M
part --source rootfs            --fstype=ext4 --label root            --align 4
```

## meta-rz-common/wic/rz-image-bootpart-mmc1.wks
```
# short-description: Create SD card image with a boot partition
# long-description: Creates a partitioned SD card image. Boot files
# are located in the first vfat partition.

part /boot --source bootimg-partition --ondisk mmcblk1 --fstype=vfat --label boot --active --align 4
part / --source rootfs --ondisk mmcblk1 --fstype=ext4 --label root --align 4
```

## meta-rz-distro/conf/distro/rz-bsp-plus.conf
```bitbake
require conf/distro/poky.conf

DISTRO = "rz-bsp-plus"
DISTROOVERRIDES = "poky:rz-bsp-plus"

# Override these in poky based distros
DISTRO_FEATURES:append = " pam can"
DISTRO_FEATURES:remove = " x11"

MACHINE_ESSENTIAL_EXTRA_RDEPENDS += "kernel-image kernel-devicetree"

SANITY_TESTED_DISTROS ?= " \
	ubuntu-22.04 \n \
	"

# No docker support

# Using Systemd as Initialization Manager
INIT_MANAGER = "systemd"

# Using systemd-journald without a traditional syslog daemon
VIRTUAL-RUNTIME_syslog = ""
VIRTUAL-RUNTIME_base-utils-syslog = ""

IMAGE_FEATURES:append = " rz-bsp-plus-tools"

FEATURE_PACKAGES_rz-bsp-plus-tools = " \
	packagegroup-rz-vlp-tools-base \
	packagegroup-rz-vlp-tools-multimedia \
	packagegroup-rz-vlp-tools-benchmark \
"
```

## meta-rz-distro/conf/distro/rz-bsp.conf
```bitbake
require conf/distro/poky.conf

DISTRO = "rz-bsp"
DISTROOVERRIDES = "poky:rz-bsp"

# Override these in poky based distros
DISTRO_FEATURES:append = " pam can"
DISTRO_FEATURES:remove = " x11"

MACHINE_ESSENTIAL_EXTRA_RDEPENDS += "kernel-image kernel-devicetree"

SANITY_TESTED_DISTROS ?= " \
	ubuntu-22.04 \n \
	"

IMAGE_INSTALL:append = " \
	${@bb.utils.contains('DISTRO_FEATURES', 'docker', ' packagegroup-docker', '',d)} \
"

# Using Systemd as Initialization Manager
INIT_MANAGER = "systemd"

# Using systemd-journald without a traditional syslog daemon
VIRTUAL-RUNTIME_syslog = ""
VIRTUAL-RUNTIME_base-utils-syslog = ""
```

## meta-rz-distro/conf/layer.conf
```bitbake
# We have a conf and classes directory, add to BBPATH
BBPATH .= ":${LAYERDIR}"

# We have recipes-* directories, add to BBFILES
BBFILES += "${LAYERDIR}/recipes-*/*/*.bb \
            ${LAYERDIR}/recipes-*/*/*.bbappend"

BBFILE_COLLECTIONS += "meta-rz-distro"
BBFILE_PATTERN_meta-rz-distro = "^${LAYERDIR}/"
BBFILE_PRIORITY_meta-rz-distro = "15"

LAYERDEPENDS_meta-rz-distro = "core meta-rz-bsp"
LAYERSERIES_COMPAT_meta-rz-distro = "scarthgap"
```

## meta-rzfive/conf/layer.conf
```bitbake
# We have a conf and classes directory, add to BBPATH
BBPATH .= ":${LAYERDIR}"

# We have recipes-* directories, add to BBFILES
BBFILES += "${LAYERDIR}/recipes-*/*/*.bb \
            ${LAYERDIR}/recipes-*/*/*.bbappend"

BBFILE_COLLECTIONS += "rzfive"
BBFILE_PATTERN_rzfive = "^${LAYERDIR}/"
BBFILE_PRIORITY_rzfive = "15"

LAYERDEPENDS_rzfive = "rz-common"
LAYERSERIES_COMPAT_rzfive = "dunfell"
```

## meta-rzfive/conf/machine/include/riscv/tune-rz-rv64.inc
```bitbake
require conf/machine/include/riscv/tune-riscv.inc

TUNEVALID[rz-rv64] = "Renesas RZ RISC-V 64-bit Series"

AVAILTUNES += " rz-rv64"

# RZ RISC-V 64-bit LSI Group
TUNE_FEATURES:tune-rz-rv64 = "${TUNE_FEATURES:tune-riscv64} rz-rv64"
TUNE_ARCH:tune-rz-rv64 = "riscv64"
TUNE_PKGARCH:tune-rz-rv64 = "riscv64"
PACKAGE_EXTRA_ARCHS:tune-rz-rv64 = "riscv64"

TUNE_CCARGS:append = "${@bb.utils.contains('TUNE_FEATURES', 'rz-rv64', ' -mtune=rz-rv64', ' ', d)}"
```

## meta-rzfive/conf/machine/include/rzfive-common.inc
```bitbake
require conf/machine/include/${SOC_FAMILY}.inc
require include/ecc-control.inc

MACHINEOVERRIDES =. "rzfive:"

MACHINE_FEATURES = ""

KERNEL_IMAGETYPE = "Image"
IMAGE_FSTYPES_append = " tar.bz2 ext4"
IMAGE_FSTYPES_append = " ${@oe.utils.conditional("WKS_SUPPORT", "1", "wic.gz wic.bmap", "", d)} "

SERIAL_CONSOLES = "115200;ttySC0"

# Configuration for OPENSBI
EXTRA_IMAGEDEPENDS += " opensbi"

# Add variable to Build Configuration in build log
BUILDCFG_VARS_append = " SOC_FAMILY"

# We must disable ptest when can not use GPLv3 License,
# ptest require many package, which have GPLv3 License,
DISTRO_FEATURES_remove += "${@bb.utils.contains("INCOMPATIBLE_LICENSE", "GPLv3", "ptest", "",d)}"

# Match version between native and target sysroot in meta-gplv2 when not using GPLv3.
PREFERRED_VERSION_gdbm-native ?= "${@bb.utils.contains("INCOMPATIBLE_LICENSE", "GPLv3", "1.8.3", "",d)}"

# u-boot
PREFERRED_VERSION_u-boot = "v2021.10%"
EXTRA_IMAGEDEPENDS += " u-boot"

PACKAGE_INSTALL_remove += " optee-client v4l2-init "

DISTRO_FEATURES_append = " docker"

# All related Docker packages setting
GOVERSION = "${@'1.16' if 'docker' in '${DISTRO_FEATURES}' else '1.14'}"
PREFERRED_VERSION_go = "${GOVERSION}"
PREFERRED_VERSION_containerd-opencontainers = "v1.6.8%"
PREFERRED_VERSION_docker-ce = "20.10.17-ce%"
PREFERRED_VERSION_runc-docker = "1.1.3%"
```
