## conf/machine/smarc-rzg2l.conf
```bitbake
#@TYPE: Machine
#@NAME: smarc-rzg2l machine
#@DESCRIPTION: RZ/G2L SMARC platform

SOC_FAMILY = "r9a07g044l"
require conf/machine/include/rzg2l-common.inc
require conf/machine/include/cip-core.inc

DEFAULTTUNE ?= "cortexa55"

TUNE_CONF ?= "conf/machine/include/tune-cortexa55.inc"
require ${TUNE_CONF}

PREFERRED_PROVIDER_virtual/kernel="linux-renesas"

UBOOT_CONFIG ??= "smarc-rzg2l"
UBOOT_CONFIG[smarc-rzg2l] = "smarc-rzg2l_defconfig"

# flash writer
EXTRA_IMAGEDEPENDS += " flash-writer"
```

## conf/machine/smarc-rzg2lc.conf
```bitbake
#@TYPE: Machine
#@NAME: smarc-rzg2lc machine
#@DESCRIPTION: RZ/G2LC SMARC platform

SOC_FAMILY = "r9a07g044c"
require conf/machine/include/rzg2l-common.inc
require conf/machine/include/cip-core.inc

DEFAULTTUNE ?= "cortexa55"

TUNE_CONF ?= "conf/machine/include/tune-cortexa55.inc"
require ${TUNE_CONF}

PREFERRED_PROVIDER_virtual/kernel="linux-renesas"

UBOOT_CONFIG ??= "smarc-rzg2lc"
UBOOT_CONFIG[smarc-rzg2lc] = "smarc-rzg2lc_defconfig"

# flash writer
EXTRA_IMAGEDEPENDS += " flash-writer"

# Supported devicetree
KERNEL_DEVICETREE = " \
        renesas/r9a07g044c2-smarc.dtb \
"
```

## conf/machine/smarc-rzg2ul.conf
```bitbake
#@TYPE: Machine
#@NAME: smarc-rzg2ul machine
#@DESCRIPTION: RZ/G2UL SMARC platform

SOC_FAMILY = "r9a07g043u"
require conf/machine/include/rzg2l-common.inc
require conf/machine/include/cip-core.inc

DEFAULTTUNE ?= "cortexa55"

TUNE_CONF ?= "conf/machine/include/tune-cortexa55.inc"
require ${TUNE_CONF}

PREFERRED_PROVIDER_virtual/kernel = "linux-renesas"

UBOOT_CONFIG ??= "smarc-rzg2ul"
UBOOT_CONFIG[smarc-rzg2ul] = "smarc-rzg2ul_defconfig"

# flash writer
EXTRA_IMAGEDEPENDS += " flash-writer"

# Supported devicetree
KERNEL_DEVICETREE = " \
	renesas/r9a07g043u11-smarc.dtb \
"
```

## conf/machine/smarc-rzv2l.conf
```bitbake
#@TYPE: Machine
#@NAME: smarc-rzv2l machine
#@DESCRIPTION: RZ/V2L SMARC platform

SOC_FAMILY = "r9a07g054l"
require conf/machine/include/rzv2l-common.inc
require conf/machine/include/cip-core.inc

DEFAULTTUNE ?= "cortexa55"

TUNE_CONF ?= "conf/machine/include/tune-cortexa55.inc"
require ${TUNE_CONF}

PREFERRED_PROVIDER_virtual/kernel="linux-renesas"

UBOOT_CONFIG ??= "smarc-rzv2l"
UBOOT_CONFIG[smarc-rzv2l] = "smarc-rzv2l_defconfig"

# flash writer
EXTRA_IMAGEDEPENDS += " flash-writer"

# Support board with PMIC. Default:yes.
# With this option enabled, build both bin files for PMIC board and Concrete board.
PMIC_SUPPORT ?= "1"

# Supported devicetree
KERNEL_DEVICETREE = " \
	renesas/r9a07g054l2-smarc.dtb \
"
```

## configs/smarc-rzf_defconfig
```kconfig
# configuration of RISC-V
CONFIG_RISCV=y
CONFIG_ARCH_RV64I=y
CONFIG_RISCV_SMODE=y
CONFIG_CACHE=y
#CONFIG_RISCV_NDS_CACHE=y
#CONFIG_V5L2_CACHE=y
CONFIG_TARGET_SMARC_RZF=y
CONFIG_RZF_DEV=y
CONFIG_DEFAULT_DEVICE_TREE="smarc-rzf"
CONFIG_DEFAULT_FDT_FILE="smarc-rzf.dtb"
CONFIG_RISCV_RDTIME=y
# configuration of U-BOOT
CONFIG_SYS_TEXT_BASE=0x50000000
CONFIG_SYS_MALLOC_F_LEN=0x2000
CONFIG_BOARD_EARLY_INIT_F=y
CONFIG_BOARD_LATE_INIT=y
CONFIG_SPL_FRAMEWORK_BOARD_INIT_F=n
CONFIG_FIT=y
CONFIG_HAVE_BLOCK_DEVICE=y
CONFIG_REGMAP=y
CONFIG_SYSCON=y
CONFIG_HUSH_PARSER=y
CONFIG_VERSION_VARIABLE=y
CONFIG_DISPLAY_BOARDINFO=y
CONFIG_DISPLAY_CPUINFO=y
CONFIG_ENV_SIZE=0x20000
CONFIG_ENV_OFFSET=0xFFFE0000
CONFIG_ENV_IS_IN_MMC=y
CONFIG_SYS_MMC_ENV_DEV=0
CONFIG_SYS_MMC_ENV_PART=2
CONFIG_ENV_OVERWRITE=y
CONFIG_SYS_RELOC_GD_ENV_ADDR=y
CONFIG_DISTRO_DEFAULTS=y
CONFIG_SUPPORT_RAW_INITRD=y
CONFIG_USE_BOOTARGS=y
CONFIG_BOOTARGS="root=/dev/nfs rw nfsroot=192.168.0.1:/export/rfs ip=192.168.0.20"
CONFIG_BOOTCOMMAND="ext4load mmc 1:1 0x48080000 Image;ext4load mmc 1:1 0x48000000 "CONFIG_DEFAULT_FDT_FILE";booti 0x48080000 - 0x48000000"
CONFIG_SMBIOS_MANUFACTURER=""
CONFIG_SMBIOS_PRODUCT_NAME=""
# configuration of OF
CONFIG_OF_CONTROL=y
CONFIG_OF_SEPARATE=y
CONFIG_OF_LIST="smarc-rzf"
CONFIG_OF_LIBFDT_OVERLAY=y
# configuration of driver
CONFIG_CLK=y
CONFIG_CLK_RENESAS=y
CONFIG_CLK_RCAR_GEN3=y
CONFIG_CLK_R9A07G043F=y
CONFIG_DM_GPIO=y
CONFIG_RCAR_GPIO=y
CONFIG_RZG2L_GPIO=y
CONFIG_PINCTRL=y
CONFIG_PINCTRL_PFC=y
CONFIG_PINCTRL_PFC_RZG2L=y
CONFIG_DM_I2C=y
CONFIG_SYS_I2C_RZG2L_RIIC=y
CONFIG_SH_SDHI=y
CONFIG_BITBANGMII=y
CONFIG_PHY_MICREL=y
CONFIG_PHY_MICREL_KSZ90X1=y
CONFIG_DM_ETH=y
CONFIG_RENESAS_RAVB=y
CONFIG_PCI=y
CONFIG_DM_PCI=y
CONFIG_PCI_RCAR_GEN3=y
CONFIG_DM_REGULATOR=y
CONFIG_DM_REGULATOR_FIXED=y
CONFIG_DM_REGULATOR_GPIO=y
CONFIG_SCIF_CONSOLE=y
CONFIG_USB=y
CONFIG_DM_USB=y
CONFIG_USB_XHCI_HCD=y
CONFIG_USB_EHCI_HCD=y
CONFIG_USB_EHCI_GENERIC=y
CONFIG_USB_STORAGE=y
CONFIG_MMC=y
CONFIG_DM_MMC=n
CONFIG_SUPPORT_EMMC_RPMB=y
CONFIG_SUPPORT_EMMC_BOOT=y
CONFIG_PHY=y
CONFIG_BLK=y
CONFIG_WDT=y
CONFIG_RENESAS_RZG2LWDT=y
# configuration of SPL
CONFIG_SPL=y
CONFIG_SPL_CLK=y
CONFIG_SPL_CACHE=y
CONFIG_SPL_CACHE_SUPPORT=y
CONFIG_SPL_CPU_SUPPORT=y
CONFIG_SPL_SMP=n
CONFIG_SPL_SEPARATE_BSS=y
CONFIG_SPL_FIT=y
CONFIG_SPL_LOAD_FIT=y
CONFIG_USE_SPL_FIT_GENERATOR=y
CONFIG_SPL_FIT_GENERATOR="arch/riscv/lib/mkimage_fit_opensbi.sh"
CONFIG_SPL_OF_CONTROL=y
CONFIG_SPL_OF_LIST="rzv-dev_ddr4"
CONFIG_SPL_DM=y
CONFIG_SPL_DM_SERIAL=y
CONFIG_SPL_NOR_SUPPORT=y
CONFIG_SPL_BLK=y
CONFIG_SPL_MMC_SUPPORT=y
CONFIG_SYS_MMCSD_RAW_MODE_U_BOOT_USE_SECTOR=y
CONFIG_SYS_MMCSD_RAW_MODE_U_BOOT_SECTOR=0x100
# configuration of CMD
CONFIG_CMD_BOOTZ=y
CONFIG_CMD_GPIO=y
CONFIG_CMD_I2C=y
CONFIG_CMD_MMC=y
CONFIG_CMD_PCI=y
CONFIG_CMD_USB=y
CONFIG_CMD_DHCP=y
CONFIG_CMD_MII=y
CONFIG_CMD_PING=y
CONFIG_CMD_EXT2=y
CONFIG_CMD_EXT4=y
CONFIG_CMD_EXT4_WRITE=y
CONFIG_CMD_FAT=y
CONFIG_CMD_FS_GENERIC=y
CONFIG_CMD_SBI=y
CONFIG_CMD_WDT=y
# configuration of DDR settings
#CONFIG_RZF_DDR_C_010_D3_02_2=y
#CONFIG_RZF_DDR_C_010_D4_01_1=y
#CONFIG_RZF_DDR_C_010_D4_01_2=y
#CONFIG_RZF_DDR_C_011_D3_01_2=y
#CONFIG_RZF_DDR_C_011_D4_01_1=y
CONFIG_RZF_DDR_C_011_D4_01_2=y
#CONFIG_RZF_DDR_SWIZZLE_T1BC=y
#CONFIG_RZF_DDR_SWIZZLE_T1C=y
#CONFIG_RZF_DDR_SWIZZLE_T2C=y
#CONFIG_RZF_DDR_SWIZZLE_T3BC=y
#CONFIG_RZF_DDR_SWIZZLE_T3BCUD=y
CONFIG_RZF_DDR_SWIZZLE_T3BCUD2=y
#CONFIG_RZF_DDR_SWIZZLE_T3BCUL=y
#CONFIG_RZF_DDR_SWIZZLE_T3CL=y
CONFIG_RZF_DDR_PLL4=1600
#CONFIG_RZF_DDR_PLL4=1333
CONFIG_RZF_DDR_SIZE=0x40000000
# configuration of OpenSBI debug
CONFIG_DEBUG_OPENSBI=y
CONFIG_SBI_V02=y
CONFIG_CMD_EXCEPTION=y
CONFIG_SPI_FLASH=y
CONFIG_SPI_FLASH_BAR=y
CONFIG_SPI_FLASH_USE_4K_SECTORS=y
CONFIG_SPI=y
CONFIG_DM_SPI=y
CONFIG_SPI_FLASH_WINBOND=y
CONFIG_RENESAS_RPC_SPI=y
CONFIG_CMD_SF=y
CONFIG_CMD_SPI=y
CONFIG_SPI_FLASH_STMICRO=y
CONFIG_DM_SPI_FLASH=y
```

## configs/smarc-rzg2lc_defconfig
```kconfig
CONFIG_ARM=y
CONFIG_ARCH_CPU_INIT=y
CONFIG_ARCH_RMOBILE=y
CONFIG_SYS_TEXT_BASE=0x50000000
CONFIG_ENV_SIZE=0x20000
CONFIG_ENV_OFFSET=0xFFFE0000
CONFIG_DM_GPIO=y
CONFIG_RCAR_GEN3=y
CONFIG_R9A07G044C=y
CONFIG_SYS_LOAD_ADDR=0x58000000
CONFIG_TARGET_SMARC_RZG2LC=y
CONFIG_DEFAULT_DEVICE_TREE="smarc-rzg2lc"
CONFIG_SMBIOS_PRODUCT_NAME=""
CONFIG_SPL=n
CONFIG_FIT=y
CONFIG_USE_BOOTARGS=y
CONFIG_BOOTARGS="rw rootwait earlycon root=/dev/mmcblk0p1"
CONFIG_SUPPORT_RAW_INITRD=y
CONFIG_DEFAULT_FDT_FILE="smarc-rzg2lc.dtb"
CONFIG_VERSION_VARIABLE=y
CONFIG_HUSH_PARSER=y
CONFIG_CMD_BOOTZ=y
CONFIG_CMD_GPIO=y
CONFIG_CMD_I2C=y
CONFIG_CMD_MMC=y
CONFIG_CMD_PCI=y
CONFIG_CMD_USB=y
CONFIG_CMD_DHCP=y
CONFIG_CMD_MII=y
CONFIG_CMD_PING=y
CONFIG_CMD_EXT2=y
CONFIG_CMD_EXT4=y
CONFIG_CMD_EXT4_WRITE=y
CONFIG_CMD_FAT=y
CONFIG_CMD_FS_GENERIC=y
CONFIG_OF_CONTROL=y
CONFIG_OF_LIST="smarc-rzg2lc"
CONFIG_MULTI_DTB_FIT_LZO=y
CONFIG_MULTI_DTB_FIT_USER_DEFINED_AREA=y
CONFIG_ENV_OVERWRITE=y
CONFIG_SYS_RELOC_GD_ENV_ADDR=y
CONFIG_REGMAP=y
CONFIG_SYSCON=y
CONFIG_CLK=y
CONFIG_CLK_RENESAS=y
CONFIG_CLK_R9A07G044L=y
CONFIG_RCAR_GPIO=y
CONFIG_PINCTRL_PFC_RZG2L=y
CONFIG_RZG2L_GPIO=y
CONFIG_DM_I2C=y
CONFIG_SYS_I2C_RCAR_IIC=y
CONFIG_SH_SDHI=y
CONFIG_BITBANGMII=y
CONFIG_PHY_MICREL=y
CONFIG_PHY_MICREL_KSZ90X1=y
CONFIG_DM_ETH=y
CONFIG_RENESAS_RAVB=y
CONFIG_PCI=y
CONFIG_DM_PCI=y
CONFIG_PCI_RCAR_GEN3=y
CONFIG_DM_REGULATOR=y
CONFIG_DM_REGULATOR_FIXED=y
CONFIG_DM_REGULATOR_GPIO=y
CONFIG_SCIF_CONSOLE=y
CONFIG_TEE=y
CONFIG_OPTEE=y
CONFIG_USB=y
CONFIG_DM_USB=y
CONFIG_USB_XHCI_HCD=y
CONFIG_USB_EHCI_HCD=y
CONFIG_USB_EHCI_GENERIC=y
CONFIG_USB_STORAGE=y
CONFIG_OF_LIBFDT_OVERLAY=y
CONFIG_SMBIOS_MANUFACTURER=""
CONFIG_ENV_IS_IN_MMC=y
CONFIG_SYS_RELOC_GD_ENV_ADDR=y
CONFIG_SYS_MMC_ENV_DEV=0
CONFIG_SYS_MMC_ENV_PART=2
CONFIG_SYS_I2C_RZG2L_RIIC=y
CONFIG_WDT=y
CONFIG_RENESAS_RZG2LWDT=y
CONFIG_CMD_WDT=y
CONFIG_BOARD_LATE_INIT=y
CONFIG_SPI_FLASH=y
CONFIG_SPI_FLASH_BAR=y
CONFIG_SPI_FLASH_USE_4K_SECTORS=y
CONFIG_SPI=y
CONFIG_DM_SPI=y
CONFIG_SPI_FLASH_WINBOND=y
CONFIG_RENESAS_RPC_SPI=y
CONFIG_CMD_SF=y
CONFIG_CMD_SPI=y
CONFIG_SPI_FLASH_STMICRO=y
CONFIG_DM_SPI_FLASH=y
CONFIG_BOOTM_EFI=y
CONFIG_CMD_BOOTEFI=y
CONFIG_CMD_NVEDIT_EFI=y
CONFIG_CMD_EFIDEBUG=y
CONFIG_CMD_BOOTEFI_HELLO=y
CONFIG_CMD_BOOTEFI_HELLO_COMPILE=y
CONFIG_CMD_BOOTEFI_SELFTEST=y
CONFIG_CMD_GPT=y
CONFIG_EFI_PARTITION=y
CONFIG_EFI_LOADER=y
CONFIG_EFI_DEVICE_PATH_TO_TEXT=y
CONFIG_EFI_UNICODE_COLLATION_PROTOCOL2=y
CONFIG_EFI_UNICODE_CAPITALIZATION=y
CONFIG_EFI_HAVE_RUNTIME_RESET=y
CONFIG_CMD_EFI_VARIABLE_FILE_STORE=y
CONFIG_DM_RTC=y
CONFIG_EFI_GET_TIME=y
CONFIG_EFI_SET_TIME=y
CONFIG_RTC_EMULATION=y
CONFIG_CMD_DFU=y
CONFIG_FLASH_CFI_MTD=y
CONFIG_EFI_CAPSULE_FIRMWARE_FIT=y
CONFIG_EFI_CAPSULE_FIRMWARE_MANAGEMENT=y
CONFIG_EFI_CAPSULE_FIRMWARE=y
CONFIG_EFI_CAPSULE_FIRMWARE_RAW=y
CONFIG_EFI_CAPSULE_FMP_HEADER=y
CONFIG_CMD_GPT=y
CONFIG_FAT_WRITE=y
CONFIG_FS_FAT=y
CONFIG_CMD_PART=y
CONFIG_PARTITIONS=y
CONFIG_DOS_PARTITION=y
CONFIG_ISO_PARTITION=y
CONFIG_EFI_PARTITION=y
CONFIG_PARTITION_UUIDS=y
CONFIG_DISTRO_DEFAULTS=y
CONFIG_NET_RANDOM_ETHADDR=y
CONFIG_CMD_RTC=y
CONFIG_EFI_RUNTIME_UPDATE_CAPSULE=y
CONFIG_EFI_HAVE_CAPSULE_SUPPORT=y
CONFIG_EFI_CAPSULE_ON_DISK=y
CONFIG_SPL_DFU=y
CONFIG_MTD=y
CONFIG_DM_MTD=y
CONFIG_DFU_MTD=y
CONFIG_SPL_DFU_MTD=y
CONFIG_DFU_SF=y
CONFIG_DFU_OVER_USB=y
CONFIG_DFU=y
CONFIG_DFU_MMC=y
CONFIG_DFU_NAND=y
CONFIG_DFU_RAM=y
CONFIG_DFU_SF_PART=y
CONFIG_DFU_TIMEOUT=y
CONFIG_CMD_DFU=y
CONFIG_OF_LIBFDT=y
CONFIG_DFU_OVER_TFTP=y
CONFIG_DFU_TFTP=y
```

## meta-rz-boards/conf/distro/rz-vlp.conf
```bitbake
require conf/distro/rz-bsp.conf

DISTRO = "rz-vlp"
DISTROOVERRIDES = "poky:rz-bsp:rz-vlp"

IMAGE_FEATURES:append = " rz-vlp-tools"

FEATURE_PACKAGES_rz-vlp-tools = " \
	packagegroup-rz-vlp-tools-base \
	packagegroup-rz-vlp-tools-multimedia \
	packagegroup-rz-vlp-tools-benchmark \
"
```

## meta-rz-bsp/conf/layer.conf
```bitbake
# We have a conf and classes directory, add to BBPATH
BBPATH .= ":${LAYERDIR}"

# We have recipes-* directories, add to BBFILES
BBFILES += "${LAYERDIR}/recipes-*/*/*.bb \
            ${LAYERDIR}/recipes-*/*/*.bbappend"

BBFILE_COLLECTIONS += "meta-rz-bsp"
BBFILE_PATTERN_meta-rz-bsp = "^${LAYERDIR}/"
BBFILE_PRIORITY_meta-rz-bsp = "15"

LAYERDEPENDS_meta-rz-bsp = "core"
LAYERSERIES_COMPAT_meta-rz-bsp = "scarthgap"
```

## meta-rz-bsp/conf/machine/rzg3e-dev.conf
```bitbake
#@TYPE: Machine
#@NAME: rzg3e-dev
#@DESCRIPTION: Reference machine configuration for the RZ/G3E Development Board

require conf/machine/include/arm/armv8-2a/tune-cortexa55.inc
require conf/machine/include/rz-common.inc
require conf/machine/include/rzg3e-family.inc

# Machine configuration
MACHINE_FEATURES:append = " alsa ext2 pci serial usbgadget usbhost can"

# Trusted Firmware-A configuration
PREFERRED_VERSION_trusted-firmware-a ?= "2.10%"
TFA_PLATFORM ?= "g3e"
TFA_BOARD ?= "dev_1"
TFA_UBOOT ?= "1"
TFA_BUILD_TARGET ?= "bl2 fip"
BL2_BOOT_TARGET ?= "spi mmc esd"
EXTRA_IMAGEDEPENDS += " firmware-pack"

# U-Boot Configuration
UBOOT_CONFIG ??= "rzg3e-dev"
UBOOT_CONFIG[rzg3e-dev] = "rzg3e-dev_defconfig"
PREFERRED_VERSION_u-boot ?= "2023.10%"

# Linux kernel configuration
KERNEL_IMAGETYPE ?= "Image"
KERNEL_DEVICETREE ?= "renesas/r9a09g047e54-dev.dtb"

IMAGE_BOOT_FILES = " \
	bl2_bp_spi-${MACHINE}.bin \
	bl2_bp_spi-${MACHINE}.srec \
	bl2_bp_mmc-${MACHINE}.bin \
	bl2_bp_mmc-${MACHINE}.srec \
	fip-${MACHINE}.bin \
	fip-${MACHINE}.srec \
"
do_image_wic[depends] += "firmware-pack:do_deploy"
```

## meta-rz-bsp/conf/machine/smarc-rzg2l.conf
```bitbake
#@TYPE: Machine
#@NAME: smarc-rzg2l machine
#@DESCRIPTION: RZ/G2L SMARC platform

require conf/machine/include/arm/armv8-2a/tune-cortexa55.inc
require conf/machine/include/rz-common.inc
require conf/machine/include/rzg2l-family.inc

# Trusted Firmware-A configuration
PREFERRED_VERSION_trusted-firmware-a ?= "2.9%"
TFA_PLATFORM ?= "g2l"
TFA_BOARD ?= "smarc_2"
TFA_UBOOT ?= "1"
TFA_BUILD_TARGET ?= "bl2 bl31 fip"
BL2_BOOT_TARGET ?= "spi mmc esd"
TFA_PMIC_EXTRA_OEMAKE ?= " \
	BOARD=smarc_pmic_2 \
"
BL2_ADJUST_VMA ?= "0x00011E00"
FIP_ADJUST_VMA ?= "0x0000"

# U-Boot Configuration
UBOOT_CONFIG ??= "smarc-rzg2l"
UBOOT_CONFIG[smarc-rzg2l] = "smarc-rzg2l_defconfig"
PREFERRED_VERSION_u-boot = "2021.10%"

# Flash Writer configuration
FLASH_WRITER_BOARD ?= "RZG2L_SMARC"
FLASH_WRITER_PMIC_BOARD ?= "RZG2L_SMARC_PMIC"

# Support board with PMIC. Default:yes.
# With this option enabled, build both bin files for PMIC board and Concrete board.
PMIC_SUPPORT ?= "1"

# Wic image
WKS_FILE = "${@oe.utils.conditional("PMIC_SUPPORT", "1", "rz-image-bootpart-esd-pmic.wks", "rz-image-bootpart-esd.wks", d)}"

IMAGE_BOOT_FILES = " \
	bl2_bp_spi-${MACHINE}_pmic.bin \
	bl2_bp_spi-${MACHINE}.bin \
	bl2_bp_mmc-${MACHINE}_pmic.bin \
	bl2_bp_mmc-${MACHINE}.bin \
	fip-${MACHINE}_pmic.bin \
	fip-${MACHINE}.bin \
	bl2_bp_spi-${MACHINE}_pmic.srec \
	bl2_bp_spi-${MACHINE}.srec \
	bl2_bp_mmc-${MACHINE}_pmic.srec \
	bl2_bp_mmc-${MACHINE}.srec \
	fip-${MACHINE}_pmic.srec \
	fip-${MACHINE}.srec \
	Flash_Writer_SCIF_RZG2L_SMARC_PMIC_DDR4_2GB_1PCS.mot \
	Flash_Writer_SCIF_RZG2L_SMARC_DDR4_2GB.mot \
"
do_image_wic[depends] += "firmware-pack:do_deploy flash-writer:do_deploy"

MACHINE_FEATURES:append = " mali-g31 hwh264dec hwh264enc"
```

## meta-rz-bsp/conf/machine/smarc-rzg2lc.conf
```bitbake
#@TYPE: Machine
#@NAME: smarc-rzg2lc machine
#@DESCRIPTION: RZ/G2LC SMARC platform

require conf/machine/include/rzg2l-family.inc
require conf/machine/include/arm/armv8-2a/tune-cortexa55.inc
require conf/machine/include/rz-common.inc

# Trusted Firmware-A configuration
PREFERRED_VERSION_trusted-firmware-a ?= "2.9%"
TFA_PLATFORM ?= "g2l"
TFA_BOARD ?= "smarc_1"
TFA_UBOOT ?= "1"
TFA_BUILD_TARGET ?= "bl2 bl31 fip"
BL2_BOOT_TARGET ?= "spi mmc esd"
BL2_ADJUST_VMA ?= "0x00011E00"
FIP_ADJUST_VMA ?= "0x0000"

# U-Boot Configuration
UBOOT_CONFIG ??= "smarc-rzg2lc"
UBOOT_CONFIG[smarc-rzg2lc] = "smarc-rzg2lc_defconfig"
PREFERRED_VERSION_u-boot ?= "2021.10%"

# Flash Writer configuration
FLASH_WRITER_BOARD ?= "RZG2LC_SMARC"

# Wic image
WKS_FILE = "rz-image-bootpart-esd.wks"

IMAGE_BOOT_FILES = " \
	bl2_bp_spi-${MACHINE}.bin \
	bl2_bp_mmc-${MACHINE}.bin \
	fip-${MACHINE}.bin \
	bl2_bp_spi-${MACHINE}.srec \
	bl2_bp_mmc-${MACHINE}.srec \
	fip-${MACHINE}.srec \
	Flash_Writer_SCIF_RZG2LC_SMARC_DDR4_1GB_1PCS.mot \
"
do_image_wic[depends] += "firmware-pack:do_deploy flash-writer:do_deploy"

MACHINE_FEATURES:append = " mali-g31"
```
