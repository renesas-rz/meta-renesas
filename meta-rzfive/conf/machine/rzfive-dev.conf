## meta-rzfive/conf/machine/rzfive-dev.conf
```bitbake
#@TYPE: Machine
#@NAME: rzfive-dev machine
#@DESCRIPTION: RZ/Five Development EVK platform

SOC_FAMILY = "r9a07g043f"
require conf/machine/include/rzfive-common.inc
require conf/machine/include/cip-core.inc
require conf/machine/include/riscv/tune-rz-rv64.inc

PREFERRED_PROVIDER_virtual/kernel="linux-renesas"

UBOOT_CONFIG ??= "rzfive-dev"
UBOOT_CONFIG[rzfive-dev] = "rzf-dev_ddr4_defconfig"

# flash writer
EXTRA_IMAGEDEPENDS += " flash-writer"

# Supported devicetree
KERNEL_DEVICETREE = " \
	renesas/r9a07g043f01-dev.dtb \
"

IMAGE_BOOT_FILES = " \
	spl-${MACHINE}.srec \
	fit-${MACHINE}.srec \
	Flash_Writer_SCIF_RZFIVE_13MMSQ_DEV.mot \
"
WIC_INPUT_DEPENDS = "u-boot:do_deploy flash-writer:do_deploy"
```

## meta-rzfive/conf/machine/smarc-rzfive.conf
```bitbake
#@TYPE: Machine
#@NAME: smarc-rzfive machine
#@DESCRIPTION: RZ/Five SMARC platform

SOC_FAMILY = "r9a07g043f"
require conf/machine/include/rzfive-common.inc
require conf/machine/include/cip-core.inc
require conf/machine/include/riscv/tune-rz-rv64.inc

PREFERRED_PROVIDER_virtual/kernel="linux-renesas"

UBOOT_CONFIG ??= "smarc-rzfive"
UBOOT_CONFIG[smarc-rzfive] = "smarc-rzf_defconfig"

# flash writer
EXTRA_IMAGEDEPENDS += " flash-writer"

# Supported devicetree
KERNEL_DEVICETREE = " \
	renesas/r9a07g043f01-smarc.dtb \
"
```

## meta-rzg1/conf/layer.conf
```bitbake
# We have a conf and classes directory, add to BBPATH
BBPATH .= ":${LAYERDIR}"

# We have recipes-* directories, add to BBFILES
BBFILES += "${LAYERDIR}/recipes-*/*/*.bb \
    ${LAYERDIR}/recipes-*/*/*.bbappend \
"

BBFILE_COLLECTIONS += "rzg1"
BBFILE_PATTERN_rzg1 = "^${LAYERDIR}/"
BBFILE_PRIORITY_rzg1 = "15"

LAYERDEPENDS_rzg1 = "rz-common"
LAYERSERIES_COMPAT_rzg1 = "dunfell"
```

## meta-rzg1/conf/machine/include/r8a7745.inc
```bitbake
SOC_FAMILY =. "rzg1:"
require conf/machine/include/soc-family.inc
LINUXLIBCVERSION = "4.4%"
```

## meta-rzg1/conf/machine/include/r8a77470.inc
```bitbake
SOC_FAMILY =. "rzg1:"
require conf/machine/include/soc-family.inc
LINUXLIBCVERSION = "4.4%"
PREFERRED_PROVIDER_u-boot ?= "u-boot"
EXTRA_IMAGEDEPENDS += "u-boot"
```

## meta-rzg1/conf/machine/include/rzg1-common.inc
```bitbake
# Configuration for kernel
PREFERRED_PROVIDER_virtual/kernel = "linux-renesas"

MACHINEOVERRIDES =. "rzg1:"
MACHINE_FEATURES = "opengles"

KERNEL_IMAGETYPE = "uImage"
KERNEL_EXTRA_ARGS += "LOADADDR=0x40008000"

IMAGE_FSTYPES_append = " tar.bz2 ext4"

# Add variable to Build Configuration in build log
BUILDCFG_VARS_append = " SOC_FAMILY"

#add u-boot
PREFERRED_VERSION_u-boot = "v2013.01.01%"
EXTRA_IMAGEDEPENDS += " u-boot"

# We must disable ptest when can not use GPLv3 License,
# ptest require many package, which have GPLv3 License,
DISTRO_FEATURES_remove += "${@bb.utils.contains("INCOMPATIBLE_LICENSE", "GPLv3", "ptest", "",d)}"

# Match version between native and target sysroot in meta-gplv2 when not using GPLv3.
PREFERRED_VERSION_gdbm-native ?= "${@bb.utils.contains("INCOMPATIBLE_LICENSE", "GPLv3", "1.8.3", "",d)}"

BBMASK_append = " optee-client trusted-firmware-a optee-test"
IMAGE_INSTALL_remove += "optee-client"

# Avoid using these recipes in meta-rz-common, use rzg1 recipes instead
BBMASK_append = " meta-rz-common/recipes-multimedia/mmngr-module meta-rz-common/recipes-multimedia/vspmif-module"
BBMASK_append = " meta-rz-common/recipes-kernel/kernel-module-mmngr meta-rz-common/recipes-kernel/kernel-module-vspm meta-rz-common/recipes-kernel/kernel-module-vspmif"
```

## meta-rzg1/conf/machine/include/wayland-nogfx.inc
```bitbake
WAYLAND_GFX_ENABLE ?= "0"

BBMASK .= "|libegl|libgbm|wayland-kms|wayland-wsegl"
BBMASK .= "|meta-renesas/meta-rzg1/recipes-graphics/mesa"
BBMASK .= "|meta-renesas/meta-rzg1/recipes-graphics/cogl"
```

## meta-rzg1/conf/machine/islay.conf
```bitbake
#@TYPE: Machine
#@NAME: islay
#@DESCRIPTION: Machine configuration for islay systems

require conf/machine/include/r8a7745.inc
require conf/machine/include/rzg-providers.inc

MACHINE_EXTRA_RRECOMMENDS = " kernel-modules"

IMAGE_FSTYPES += "tar.bz2"

SERIAL_CONSOLE = "38400 ttySC10"

MACHINEOVERRIDES =. "lcb:"

KERNEL_DEVICETREE = "${S}/arch/arm/boot/dts/r8a7745-islay.dts"

KERNEL_EXTRA_ARGS += "LOADADDR=${UBOOT_ENTRYPOINT}"

UBOOT_MACHINE ?= "islay_config"
UBOOT_ENTRYPOINT = "0x40008000"
UBOOT_LOADADDRESS = "0x40007fc0"

PREFERRED_VERSION_linux-renesas = "3.10%"
PREFERRED_VERSION_linux-libc-headers = "3.10%"
PREFERRED_VERSION_nativesdk-linux-libc-headers = "3.10%"
PREFERRED_VERSION_u-boot = "v2013.01%"
PREFERRED_VERSION_libdrm = "2.4.45%"

MACHINE_FEATURES = "apm usbgadget usbhost vfat alsa ethernet"
```

## meta-rzg1/conf/machine/iwg20m-g1m.conf
```bitbake
#@TYPE: Machine
#@NAME: iwg20m-g1m
#@DESCRIPTION: Machine configuration for iWave's iwg20m-g1m systems
SOC_FAMILY = "r8a7743"
require conf/machine/include/${SOC_FAMILY}.inc
require conf/machine/include/rzg1-common.inc
require conf/machine/include/cip-core.inc

# Add default tune for RZG1M
DEFAULTTUNE ?= "cortexa15hf-neon-vfpv4"
require conf/machine/include/tune-cortexa15.inc

# Device tree for RZG1M
KERNEL_DEVICETREE = "\
    r8a7743-iwg20d-q7.dtb \
    r8a7743-iwg20d-q7-dbcm-ca.dtb \
    r8a7743-iwg20d-q7-rev2.dtb \
    r8a7743-iwg20d-q7-dbcm-ca-rev2.dtb \
"
SERIAL_CONSOLES = "115200;ttySC0"

#add u-boot
UBOOT_MACHINE ?= "iwg20m_q7_config"
UBOOT_ENTRYPOINT = "0x40008000"
UBOOT_LOADADDRESS = "0x40007fc0"
```

## meta-rzg1/conf/machine/iwg20m-g1n.conf
```bitbake
#@TYPE: Machine
#@NAME: iwg20m-g1n
#@DESCRIPTION: Machine configuration for iWave's iwg20m-g1n systems
SOC_FAMILY = "r8a7744"
require conf/machine/include/${SOC_FAMILY}.inc
require conf/machine/include/rzg1-common.inc
require conf/machine/include/cip-core.inc

# Add default tune for RZG1N
DEFAULTTUNE ?= "cortexa15hf-neon-vfpv4"
require conf/machine/include/tune-cortexa15.inc

# Device tree for RZG1N
KERNEL_DEVICETREE = "\
    r8a7744-iwg20d-q7.dtb \
    r8a7744-iwg20d-q7-dbcm-ca.dtb \
    r8a7744-iwg20d-q7-rev2.dtb \
    r8a7744-iwg20d-q7-dbcm-ca-rev2.dtb \
"

SERIAL_CONSOLES = "115200;ttySC0"

#add u-boot
UBOOT_MACHINE ?= "iwg20m_q7_config"
UBOOT_ENTRYPOINT = "0x40008000"
UBOOT_LOADADDRESS = "0x40007fc0"
```

## meta-rzg1/conf/machine/iwg20m.conf
```bitbake
#@TYPE: Machine
#@NAME: iwg20m
#@DESCRIPTION: Machine configuration for iWave's iwg20m systems

require conf/machine/include/${SOC_FAMILY}.inc
require conf/machine/include/tune-cortexa15.inc

# Add default tune for RZG1M
DEFAULTTUNE ?= "cortexa15hf-neon"

MACHINE_FEATURES = ""

MACHINE_EXTRA_RRECOMMENDS = " kernel-modules"

IMAGE_FSTYPES_append = " tar.bz2 ext4 cpio.gz"

SERIAL_CONSOLE = "115200 ttySC0"

MACHINEOVERRIDES =. "lcb:"

KERNEL_EXTRA_ARGS += "LOADADDR=0x40008000"
KERNEL_IMAGETYPE = "uImage"

# Configuration for kernel
PREFERRED_PROVIDER_virtual/kernel = "linux-renesas"

# Device tree for RZG1M
KERNEL_DEVICETREE_r8a7743 = "\
    r8a7743-iwg20m.dtb \
"

# libdrm
PREFERRED_VERSION_libdrm = "2.4.83"

# Add variable to Build Configuration in build log
BUILDCFG_VARS_append = " SOC_FAMILY"
```

## meta-rzg1/conf/machine/iwg21m.conf
```bitbake
#@TYPE: Machine
#@NAME: iwg21m
#@DESCRIPTION: Machine configuration for running iwg21m
SOC_FAMILY = "r8a7742"
require conf/machine/include/${SOC_FAMILY}.inc
require conf/machine/include/rzg1-common.inc
require conf/machine/include/cip-core.inc

# Add default tune for RZG1H
DEFAULTTUNE ?= "cortexa15hf-neon-vfpv4"
require conf/machine/include/tune-cortexa15.inc

# Device tree for RZG1H
KERNEL_DEVICETREE_r8a7742 = " \
    r8a7742-iwg21d-q7.dtb \
    r8a7742-iwg21d-q7-dbcm-ca.dtb \
    r8a7742-iwg21d-q7-rev2.dtb \
    r8a7742-iwg21d-q7-dbcm-ca-rev2.dtb \
"
SERIAL_CONSOLES = "115200;ttySC2"

#add u-boot
UBOOT_MACHINE ?= "iwg21m_q7_config"
UBOOT_ENTRYPOINT = "0x40008000"
UBOOT_LOADADDRESS = "0x40007fc0"
```

## meta-rzg1/conf/machine/iwg22m.conf
```bitbake
#@TYPE: Machine
#@NAME: iwg22m
#@DESCRIPTION: Machine configuration for iWave's iwg22m systems
SOC_FAMILY = "r8a7745"
require conf/machine/include/${SOC_FAMILY}.inc
require conf/machine/include/rzg1-common.inc
require conf/machine/include/cip-core.inc

# Add default tune for RZG1E
DEFAULTTUNE ?= "cortexa7hf-neon-vfpv4"
require conf/machine/include/tune-cortexa7.inc

# Device tree for RZG1E
KERNEL_DEVICETREE = "\
    r8a7745-iwg22d-sodimm-dbhd-ca.dtb \
    r8a7745-iwg22d-sodimm.dtb \
    r8a7745-iwg22d-sodimm-dbhd-ca-rev3.dtb \
    r8a7745-iwg22d-sodimm-rev3.dtb \
"
SERIAL_CONSOLES = "115200;ttySC3"

#add u-boot
UBOOT_MACHINE ?= "iwg22m_sm_config"
UBOOT_ENTRYPOINT = "0x40008000"
UBOOT_LOADADDRESS = "0x40007fc0"
```

## meta-rzg1/conf/machine/iwg23s.conf
```bitbake
#@TYPE: Machine
#@NAME: iwg23s
#@DESCRIPTION: Machine configuration for iWave's iwg23s systems
SOC_FAMILY = "r8a77470"
require conf/machine/include/${SOC_FAMILY}.inc
require conf/machine/include/rzg1-common.inc
require conf/machine/include/cip-core.inc

# Add default tune for RZG1C
DEFAULTTUNE ?= "cortexa7hf-neon-vfpv4"
require conf/machine/include/tune-cortexa7.inc

# Device tree for RZG1C
KERNEL_DEVICETREE = "\
    r8a77470-iwg23s-sbc.dtb \
    r8a77470-iwg23s-sbc-rev2.dtb \
"
SERIAL_CONSOLES = "115200;ttySC1"

#add u-boot
UBOOT_MACHINE ?= "iwg23s_config"
UBOOT_ENTRYPOINT = "0x40008000"
UBOOT_LOADADDRESS = "0x40007fc0"
```

## meta-rzg1/conf/machine/skrzg1e.conf
```bitbake
#@TYPE: Machine
#@NAME: skrzg1e
#@DESCRIPTION: Machine configuration for skrzg1e systems

require conf/machine/include/r8a7745.inc
require conf/machine/include/rzg-providers.inc

MACHINE_EXTRA_RRECOMMENDS = " kernel-modules"

IMAGE_FSTYPES += "tar.bz2"

SERIAL_CONSOLE = "38400 ttySC10"

MACHINEOVERRIDES =. "lcb:"

KERNEL_DEVICETREE = "${S}/arch/arm/boot/dts/r8a7745-skrzg1e.dts"

KERNEL_EXTRA_ARGS += "LOADADDR=${UBOOT_ENTRYPOINT}"

UBOOT_MACHINE ?= "skrzg1e_config"
UBOOT_ENTRYPOINT = "0x40008000"
UBOOT_LOADADDRESS = "0x40007fc0"

PREFERRED_VERSION_linux-renesas = "4.4%"
PREFERRED_VERSION_linux-libc-headers = "4.4%"
PREFERRED_VERSION_nativesdk-linux-libc-headers = "4.4%"
PREFERRED_VERSION_u-boot = "v2015.07%"
PREFERRED_VERSION_libdrm = "2.4.65%"

MACHINE_FEATURES = "apm usbgadget usbhost vfat alsa ethernet"
```

## meta-rzg1/conf/machine/skrzg1m.conf
```bitbake
#@TYPE: Machine
#@NAME: skrzg1m
#@DESCRIPTION: Machine configuration for skrzg1m systems

require conf/machine/include/r8a7743.inc
require conf/machine/include/rzg-providers.inc

MACHINE_EXTRA_RRECOMMENDS = " kernel-modules"

IMAGE_FSTYPES += "tar.bz2"

SERIAL_CONSOLE = "38400 ttySC10"

MACHINEOVERRIDES =. "lcb:"

KERNEL_DEVICETREE = "${S}/arch/arm/boot/dts/r8a7743-skrzg1m.dts"

KERNEL_EXTRA_ARGS += "LOADADDR=${UBOOT_ENTRYPOINT}"

UBOOT_MACHINE ?= "skrzg1m_config"
UBOOT_ENTRYPOINT = "0x40008000"
UBOOT_LOADADDRESS = "0x40007fc0"

PREFERRED_VERSION_linux-renesas = "4.4%"
PREFERRED_VERSION_u-boot = "v2015.07%"

PREFERRED_VERSION_libdrm = "2.4.65%"

MACHINE_FEATURES = "apm usbgadget usbhost vfat alsa ethernet"

LINUXLIBCVERSION = "4.4%"
```

## meta-rzg2h/conf/machine/hihope-rzg2m.conf
```bitbake
#@TYPE: Machine
#@NAME: hihope-rzg2m machine
#@DESCRIPTION: Hoperun Technology HiHope RZ/G2M platform (hihope-rzg2m)

SOC_FAMILY = "r8a774a1"

DEFAULTTUNE ?= "cortexa57-cortexa53"
TUNE_CONF ?= "conf/machine/include/tune-cortexa57-cortexa53.inc"
require conf/machine/include/${SOC_FAMILY}.inc
require ${TUNE_CONF}
require conf/machine/include/cip-core.inc
require conf/machine/include/rzg2h-common.inc

# Configuration for kernel
PREFERRED_PROVIDER_virtual/kernel = "linux-renesas"
# Device tree for RZG2M
KERNEL_DEVICETREE = " \
    ${@oe.utils.ifelse("${ECC_FULL}" == "2"," "," \
    renesas/r8a774a1-hihope-rzg2m.dtb \
    renesas/r8a774a1-hihope-rzg2m-ex.dtb \
    renesas/r8a774a1-hihope-rzg2m-ex-idk-1110wr.dtb \
    renesas/r8a774a1-hihope-rzg2m-ex-mipi-2.1.dtb \
    renesas/r8a774a1-hihope-rzg2m-ex-mipi-2.4.dtb \
    renesas/r8a774a1-hihope-rzg2m-rev2.dtb \
    renesas/r8a774a1-hihope-rzg2m-rev2-ex.dtb \
    renesas/r8a774a1-hihope-rzg2m-rev2-ex-idk-1110wr.dtb \
    renesas/r8a774a1-hihope-rzg2m-rev2-ex-mipi-2.1.dtb \
    renesas/r8a774a1-hihope-rzg2m-rev2-ex-mipi-2.4.dtb \
    ")} \
    renesas/r8a774a3-hihope-rzg2m.dtb \
    renesas/r8a774a3-hihope-rzg2m-ex.dtb \
    renesas/r8a774a3-hihope-rzg2m-ex-idk-1110wr.dtb \
    renesas/r8a774a3-hihope-rzg2m-ex-mipi-2.1.dtb \
    renesas/r8a774a3-hihope-rzg2m-ex-mipi-2.4.dtb \
"

# G2M u-boot configure
UBOOT_CONFIG ??= "hihope-rzg2m"
UBOOT_CONFIG[hihope-rzg2m] = "hihope_rzg2_defconfig"

# flash writer
EXTRA_IMAGEDEPENDS += " flash-writer"

IMAGE_BOOT_FILES = " \
	bootparam_sa0.bin \
	bl2-${MACHINE}.bin \
	cert_header_sa6.bin \
	bl31-${MACHINE}.bin \
	tee-${MACHINE}.bin \
	u-boot-${MACHINE}.bin \
	AArch64_Flash_writer_SCIF_DUMMY_CERT_E6300400_hihope.mot \
"
WIC_INPUT_DEPENDS = "trusted-firmware-a:do_deploy u-boot:do_deploy flash-writer:do_deploy"

# Add variable to Build Configuration in build log
BUILDCFG_VARS_append = " SOC_FAMILY"

# Command using to build kernel-module-gles
HOSTTOOLS += "sync"
```

## meta-rzg2h/conf/machine/hihope-rzg2n.conf
```bitbake
#@TYPE: Machine
#@NAME: hihope-rzg2n machine
#@DESCRIPTION: Hoperun Technology HiHope RZ/G2N platform (hihope-rzg2n)

SOC_FAMILY = "r8a774b1"

DEFAULTTUNE ?= "cortexa57"
TUNE_CONF ?= "conf/machine/include/tune-cortexa57.inc"
require conf/machine/include/${SOC_FAMILY}.inc
require ${TUNE_CONF}
require conf/machine/include/cip-core.inc
require conf/machine/include/rzg2h-common.inc

# Configuration for kernel
PREFERRED_PROVIDER_virtual/kernel = "linux-renesas"
# Device tree for RZG2N
KERNEL_DEVICETREE = " \
    renesas/r8a774b1-hihope-rzg2n.dtb \
    renesas/r8a774b1-hihope-rzg2n-ex.dtb \
    renesas/r8a774b1-hihope-rzg2n-ex-idk-1110wr.dtb \
    renesas/r8a774b1-hihope-rzg2n-ex-mipi-2.1.dtb \
    renesas/r8a774b1-hihope-rzg2n-ex-mipi-2.4.dtb \
    renesas/r8a774b1-hihope-rzg2n-rev2.dtb \
    renesas/r8a774b1-hihope-rzg2n-rev2-ex.dtb \
    renesas/r8a774b1-hihope-rzg2n-rev2-ex-idk-1110wr.dtb \
    renesas/r8a774b1-hihope-rzg2n-rev2-ex-mipi-2.1.dtb \
    renesas/r8a774b1-hihope-rzg2n-rev2-ex-mipi-2.4.dtb \
"

# G2N u-boot configure
UBOOT_CONFIG ??= "hihope-rzg2n"
UBOOT_CONFIG[hihope-rzg2n] = "hihope_rzg2_defconfig"

# flash writer
EXTRA_IMAGEDEPENDS += " flash-writer"

# Add variable to Build Configuration in build log
BUILDCFG_VARS_append = " SOC_FAMILY"

# Command using to build kernel-module-gles
HOSTTOOLS += "sync"
```

## meta-rzg2h/conf/machine/include/rzg2h-common.inc
```bitbake
require conf/machine/include/rzg2-common.inc
require include/ecc-control.inc

# Configuration for ARM Trusted Firmware
EXTRA_IMAGEDEPENDS += " optee-os"

MACHINEOVERRIDES =. "rzg2h:"
```

## meta-rzg2l/conf/layer.conf
```bitbake
# We have a conf and classes directory, add to BBPATH
BBPATH .= ":${LAYERDIR}"

# We have recipes-* directories, add to BBFILES
BBFILES += "${LAYERDIR}/recipes-*/*/*.bb \
            ${LAYERDIR}/recipes-*/*/*.bbappend"

BBFILE_COLLECTIONS += "rzg2l"
BBFILE_PATTERN_rzg2l = "^${LAYERDIR}/"
BBFILE_PRIORITY_rzg2l = "15"

LAYERDEPENDS_rzg2l = "rz-common"
LAYERSERIES_COMPAT_rzg2l = "dunfell"
```

## meta-rzg2l/conf/machine/include/r9a07g044c.inc
```bitbake
SOC_FAMILY =. "rzg2l:"
require conf/machine/include/soc-family.inc
LINUXLIBCVERSION = "5.10%"
```

## meta-rzg2l/conf/machine/rzg2l-dev.conf
```bitbake
#@TYPE: Machine
#@NAME: rzg2l-dev machine
#@DESCRIPTION: RZ/G2L EVK DEV platform

SOC_FAMILY = "r9a07g044l"
require conf/machine/include/rzg2l-common.inc
require conf/machine/include/cip-core.inc

DEFAULTTUNE ?= "cortexa55"

TUNE_CONF ?= "conf/machine/include/tune-cortexa55.inc"
require ${TUNE_CONF}

PREFERRED_PROVIDER_virtual/kernel="linux-renesas"

UBOOT_CONFIG ??= "rzg2l-dev"
UBOOT_CONFIG[rzg2l-dev] = "rzg2l-dev_defconfig"

# flash writer
EXTRA_IMAGEDEPENDS += " flash-writer"

# Supported devicetree
KERNEL_DEVICETREE = " \
	renesas/r9a07g044l2-dev.dtb \
"

IMAGE_BOOT_FILES = " \
	bl2_bp-${MACHINE}.bin \
	fip-${MACHINE}.bin \
	Flash_Writer_SCIF_RZG2L_15MMSQ_DEV_DDR4_4GB.mot \
"
WIC_INPUT_DEPENDS = "firmware-pack:do_deploy flash-writer:do_deploy"
```
