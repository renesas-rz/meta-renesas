## meta-rzg2l/conf/machine/rzg2lc-dev.conf
```bitbake
#@TYPE: Machine
#@NAME: rzg2lc-dev machine
#@DESCRIPTION: RZ/G2LC Development EVK platform

SOC_FAMILY = "r9a07g044c"
require conf/machine/include/rzg2l-common.inc
require conf/machine/include/cip-core.inc

DEFAULTTUNE ?= "cortexa55"

TUNE_CONF ?= "conf/machine/include/tune-cortexa55.inc"
require ${TUNE_CONF}

PREFERRED_PROVIDER_virtual/kernel="linux-renesas"

UBOOT_CONFIG ??= "rzg2lc-dev"
UBOOT_CONFIG[rzg2lc-dev] = "rzg2lc-dev_defconfig"

# flash writer
EXTRA_IMAGEDEPENDS += " flash-writer"

# Supported devicetree
KERNEL_DEVICETREE = " \
        renesas/r9a07g044c2-dev.dtb \
"

IMAGE_BOOT_FILES = " \
	bl2_bp-${MACHINE}.bin \
	fip-${MACHINE}.bin \
	Flash_Writer_SCIF_RZG2LC_DEV_DDR3L_1GB.mot \
"
WIC_INPUT_DEPENDS = "firmware-pack:do_deploy flash-writer:do_deploy"
```
