## meta-rzg2l/conf/machine/rzg2ul-dev.conf
```bitbake
#@TYPE: Machine
#@NAME: rzg2ul-dev machine
#@DESCRIPTION: RZ/G2UL EVK  DEV platform

SOC_FAMILY = "r9a07g043u"
require conf/machine/include/rzg2l-common.inc
require conf/machine/include/cip-core.inc

DEFAULTTUNE ?= "cortexa55"

TUNE_CONF ?= "conf/machine/include/tune-cortexa55.inc"
require ${TUNE_CONF}

PREFERRED_PROVIDER_virtual/kernel="linux-renesas"

UBOOT_CONFIG ??= "rzg2ul-dev"
UBOOT_CONFIG[rzg2ul-dev] = "rzg2ul-type1-dev_defconfig"

# flash writer
EXTRA_IMAGEDEPENDS += " flash-writer"

# Supported devicetree
KERNEL_DEVICETREE = " \
	renesas/r9a07g043u11-dev.dtb \
"

IMAGE_BOOT_FILES = " \
	bl2_bp-${MACHINE}.bin \
	fip-${MACHINE}.bin \
	Flash_Writer_SCIF_RZG2UL_TYPE1_DEV_DDR4_1GB_1PCS.mot \
"
WIC_INPUT_DEPENDS = "firmware-pack:do_deploy flash-writer:do_deploy"
```

## meta-rzg2l/conf/machine/smarc-rzg2lc.conf
```bitbake
#@TYPE: Machine
#@NAME: smarc-rzg2lc machine
#@DESCRIPTION: RZ/G2LC SMARC platform

SOC_FAMILY = "r9a07g044c"
require conf/machine/include/rzg2l-common.inc
require conf/machine/include/cip-core.inc

DEFAULTTUNE ?= "cortexa55"

TUNE_CONF ?= "conf/machine/include/tune-cortexa55.inc"
require ${TUNE_CONF}

PREFERRED_PROVIDER_virtual/kernel="linux-renesas"

UBOOT_CONFIG ??= "smarc-rzg2lc"
UBOOT_CONFIG[smarc-rzg2lc] = "smarc-rzg2lc_defconfig"

# flash writer
EXTRA_IMAGEDEPENDS += " flash-writer"

# Supported devicetree
KERNEL_DEVICETREE = " \
        renesas/r9a07g044c2-smarc.dtb \
"

IMAGE_BOOT_FILES = " \
	bl2_bp-${MACHINE}.bin \
	fip-${MACHINE}.bin \
	Flash_Writer_SCIF_RZG2LC_SMARC_DDR4_1GB_1PCS.mot \
"
WIC_INPUT_DEPENDS = "firmware-pack:do_deploy flash-writer:do_deploy"
```

## meta-rzg2l/conf/machine/smarc-rzg2ul.conf
```bitbake
#@TYPE: Machine
#@NAME: smarc-rzg2ul machine
#@DESCRIPTION: RZ/G2UL SMARC platform

SOC_FAMILY = "r9a07g043u"
require conf/machine/include/rzg2l-common.inc
require conf/machine/include/cip-core.inc

DEFAULTTUNE ?= "cortexa55"

TUNE_CONF ?= "conf/machine/include/tune-cortexa55.inc"
require ${TUNE_CONF}

PREFERRED_PROVIDER_virtual/kernel = "linux-renesas"

UBOOT_CONFIG ??= "smarc-rzg2ul"
UBOOT_CONFIG[smarc-rzg2ul] = "smarc-rzg2ul_defconfig"

# flash writer
EXTRA_IMAGEDEPENDS += " flash-writer"

# Supported devicetree
KERNEL_DEVICETREE = " \
	renesas/r9a07g043u11-smarc.dtb \
"

IMAGE_BOOT_FILES = " \
	bl2_bp-${MACHINE}.bin \
	fip-${MACHINE}.bin \
	Flash_Writer_SCIF_RZG2UL_SMARC_DDR4_1GB_1PCS.mot \
"
WIC_INPUT_DEPENDS = "firmware-pack:do_deploy flash-writer:do_deploy"
```

## meta-rzg3/conf/layer.conf
```bitbake
# We have a conf and classes directory, add to BBPATH
BBPATH .= ":${LAYERDIR}"

# We have recipes-* directories, add to BBFILES
BBFILES += "${LAYERDIR}/recipes-*/*/*.bb \
            ${LAYERDIR}/recipes-*/*/*.bbappend"

BBFILE_COLLECTIONS += "rzg3"
BBFILE_PATTERN_rzg3 = "^${LAYERDIR}/"
BBFILE_PRIORITY_rzg3 = "15"

LAYERDEPENDS_rzg3 = "rz-common rzg2l"
LAYERSERIES_COMPAT_rzg3 = "dunfell"

BBMASK_append = " meta-rzg2l/recipes-bsp/firmware-pack/firmware-pack.bbappend"
BBMASK_append = " meta-rzg2l/recipes-bsp/flash-writer/flash-writer.bbappend"
```

## meta-rzg3/conf/machine/include/r9a08g045.inc
```bitbake
SOC_FAMILY =. "rzg3s:"
require conf/machine/include/soc-family.inc
LINUXLIBCVERSION = "5.10%"
```

## meta-rzg3/conf/machine/rzg3s-dev.conf
```bitbake
#@TYPE: Machine
#@NAME: rzg3s-dev machine
#@DESCRIPTION: RZ/G3S Development Board platform

SOC_FAMILY = "r9a08g045"
require conf/machine/include/rzg2l-common.inc
require conf/machine/include/cip-core.inc

DEFAULTTUNE ?= "cortexa55"

TUNE_CONF ?= "conf/machine/include/tune-cortexa55.inc"
require ${TUNE_CONF}

PREFERRED_PROVIDER_virtual/kernel="linux-renesas"

UBOOT_CONFIG ??= "rzg3s-dev"
UBOOT_CONFIG[rzg3s-dev] = "rzg3s-dev_defconfig"

# flash writer
EXTRA_IMAGEDEPENDS += " flash-writer"

EXTRA_IMAGE_FEATURES += " \
	package-management \
	ssh-server-dropbear \
"

# Supported devicetree
KERNEL_DEVICETREE = " \
	renesas/r9a08g045s31-dev.dtb \
	renesas/r9a08g045s33-dev.dtb \
"

IMAGE_BOOT_FILES = " \
	bl2_bp_spi-${MACHINE}.srec \
	bl2_bp_emmc-${MACHINE}.srec \
	fip-${MACHINE}.srec \
	FlashWriter-${MACHINE}.mot \
"
```

## meta-rzg3/conf/machine/smarc-rzg3s.conf
```bitbake
#@TYPE: Machine
#@NAME: smarc-rzg3s machine
#@DESCRIPTION: RZ/G3S SMARC platform

SOC_FAMILY = "r9a08g045"
require conf/machine/include/rzg2l-common.inc
require conf/machine/include/cip-core.inc

DEFAULTTUNE ?= "cortexa55"

TUNE_CONF ?= "conf/machine/include/tune-cortexa55.inc"
require ${TUNE_CONF}

PREFERRED_PROVIDER_virtual/kernel="linux-renesas"

UBOOT_CONFIG ??= "smarc-rzg3s"
UBOOT_CONFIG[smarc-rzg3s] = "smarc-rzg3s_defconfig"

# flash writer
EXTRA_IMAGEDEPENDS += " flash-writer"

EXTRA_IMAGE_FEATURES += " \
	package-management \
	ssh-server-dropbear \
"

# Supported devicetree
KERNEL_DEVICETREE = " \
	renesas/r9a08g045s33-smarc.dtb \
"
```

## meta-rzv2h/conf/layer.conf
```bitbake
# We have a conf and classes directory, add to BBPATH
BBPATH .= ":${LAYERDIR}"

# We have recipes-* directories, add to BBFILES
BBFILES += "${LAYERDIR}/recipes-*/*/*.bb \
            ${LAYERDIR}/recipes-*/*/*.bbappend"

BBFILES_DYNAMIC += " \
    rz-graphics:${LAYERDIR}/dynamic-layers/rz-graphics/*/*.bb \
    rz-graphics:${LAYERDIR}/dynamic-layers/rz-graphics/*/*.bbappend \
"

BBFILE_COLLECTIONS += "rzv2h"
BBFILE_PATTERN_rzv2h = "^${LAYERDIR}/"
BBFILE_PRIORITY_rzv2h = "15"

LAYERDEPENDS_rzv2h = "rz-common rzg2l"
LAYERSERIES_COMPAT_rzv2h = "dunfell"
```

## meta-rzv2h/conf/machine/include/r9a09g057.inc
```bitbake
SOC_FAMILY =. "rzv2h:"
require conf/machine/include/soc-family.inc
LINUXLIBCVERSION = "5.10%"

MACHINE_FEATURES_append = " opengles opencl hwh264enc"
```

## meta-rzv2h/conf/machine/rzv2h-dev.conf
```bitbake
#@TYPE: Machine
#@NAME: rzv2h-dev machine
#@DESCRIPTION: RZ/V2H Development Board platform

SOC_FAMILY = "r9a09g057"
require conf/machine/include/rzv2h-common.inc
require conf/machine/include/cip-core.inc

DEFAULTTUNE ?= "cortexa55"

TUNE_CONF ?= "conf/machine/include/tune-cortexa55.inc"
require ${TUNE_CONF}

PREFERRED_PROVIDER_virtual/kernel="linux-renesas"

UBOOT_CONFIG ??= "rzv2h-dev"
UBOOT_CONFIG[rzv2h-dev] = "rzv2h-dev_defconfig"

# flash writer
EXTRA_IMAGEDEPENDS += " flash-writer"

# Supported devicetree
KERNEL_DEVICETREE = " \
	renesas/r9a09g057h4-dev.dtb \
"

IMAGE_INSTALL_remove = " optee-client"

IMAGE_BOOT_FILES = " \
	bl2_bp_spi-${MACHINE}.srec \
	bl2_bp_emmc-${MACHINE}.srec \
	fip-${MACHINE}.srec \
	Flash_Writer_SCIF_RZV2H_DEV_INTERNAL_MEMORY.mot \
"
```

## meta-rzv2h/conf/machine/rzv2h-evk-alpha.conf
```bitbake
#@TYPE: Machine
#@NAME: rzv2h-evk-alpha machine
#@DESCRIPTION: RZ/V2H Evaluation Board Kit

SOC_FAMILY = "r9a09g057"
require conf/machine/include/rzv2h-common.inc
require conf/machine/include/cip-core.inc

DEFAULTTUNE ?= "cortexa55"

TUNE_CONF ?= "conf/machine/include/tune-cortexa55.inc"
require ${TUNE_CONF}

PREFERRED_PROVIDER_virtual/kernel="linux-renesas"

UBOOT_CONFIG ??= "rzv2h-evk-alpha"
UBOOT_CONFIG[rzv2h-evk-alpha] = "rzv2h-evk-alpha_defconfig"

# flash writer
EXTRA_IMAGEDEPENDS += " flash-writer"

# Supported devicetree
KERNEL_DEVICETREE = " \
	renesas/r9a09g057h4-evk-alpha.dtb \
"

IMAGE_INSTALL_remove = " optee-client"

IMAGE_BOOT_FILES = " \
	bl2_bp_spi-${MACHINE}.srec \
	bl2_bp_emmc-${MACHINE}.srec \
	fip-${MACHINE}.srec \
	Flash_Writer_SCIF_RZV2H_DEV_INTERNAL_MEMORY.mot \
"

WIC_INPUT_DEPENDS = "firmware-pack:do_deploy flash-writer:do_deploy"
```

## meta-rzv2h/conf/machine/rzv2h-evk-ver1.conf
```bitbake
#@TYPE: Machine
#@NAME: rzv2h-evk-version1 machine
#@DESCRIPTION: RZ/V2H Evaluation Board Kit

SOC_FAMILY = "r9a09g057"
require conf/machine/include/rzv2h-common.inc
require conf/machine/include/cip-core.inc

DEFAULTTUNE ?= "cortexa55"

TUNE_CONF ?= "conf/machine/include/tune-cortexa55.inc"
require ${TUNE_CONF}

PREFERRED_PROVIDER_virtual/kernel="linux-renesas"

UBOOT_CONFIG ??= "rzv2h-evk-ver1"
UBOOT_CONFIG[rzv2h-evk-ver1] = "rzv2h-evk-ver1_defconfig"

# flash writer
EXTRA_IMAGEDEPENDS += " flash-writer"

# Supported devicetree
KERNEL_DEVICETREE = " \
	renesas/r9a09g057h4-evk-ver1.dtb \
"

IMAGE_INSTALL_remove = " optee-client"

IMAGE_BOOT_FILES = " \
	bl2_bp_spi-${MACHINE}.srec \
	fip-${MACHINE}.srec \
	Flash_Writer_SCIF_RZV2H_DEV_INTERNAL_MEMORY.mot \
"

WIC_INPUT_DEPENDS = "firmware-pack:do_deploy flash-writer:do_deploy"
```

## meta-rzv2l/conf/layer.conf
```bitbake
# We have a conf and classes directory, add to BBPATH
BBPATH .= ":${LAYERDIR}"

# We have recipes-* directories, add to BBFILES
BBFILES += "${LAYERDIR}/recipes-*/*/*.bb \
            ${LAYERDIR}/recipes-*/*/*.bbappend"

BBFILE_COLLECTIONS += "rzv2l"
BBFILE_PATTERN_rzv2l = "^${LAYERDIR}/"
BBFILE_PRIORITY_rzv2l = "15"

LAYERDEPENDS_rzv2l = "rz-common rzg2l"
LAYERSERIES_COMPAT_rzv2l = "dunfell"
```

## meta-rzv2l/conf/machine/include/r9a07g054l.inc
```bitbake
SOC_FAMILY =. "rzv2l:"
require conf/machine/include/soc-family.inc
LINUXLIBCVERSION = "5.10%"

MACHINE_FEATURES_append = " opengles opencl hwh264dec hwh264enc"
```

## meta-rzv2l/conf/machine/include/rzv2l-common.inc
```bitbake
require conf/machine/include/${SOC_FAMILY}.inc
require conf/machine/include/rzg2-common.inc
require include/ecc-control.inc

# Firmware-pack
EXTRA_IMAGEDEPENDS += " firmware-pack"

MACHINEOVERRIDES =. "rzg2l:"
```

## meta-rzv2l/conf/machine/smarc-rzv2l.conf
```bitbake
#@TYPE: Machine
#@NAME: smarc-rzv2l machine
#@DESCRIPTION: RZ/V2L SMARC platform

SOC_FAMILY = "r9a07g054l"
require conf/machine/include/rzv2l-common.inc
require conf/machine/include/cip-core.inc

DEFAULTTUNE ?= "cortexa55"

TUNE_CONF ?= "conf/machine/include/tune-cortexa55.inc"
require ${TUNE_CONF}

PREFERRED_PROVIDER_virtual/kernel="linux-renesas"

UBOOT_CONFIG ??= "smarc-rzv2l"
UBOOT_CONFIG[smarc-rzv2l] = "smarc-rzv2l_defconfig"

# flash writer
EXTRA_IMAGEDEPENDS += " flash-writer"

# Support board with PMIC. Default:yes.
# With this option enabled, build both bin files for PMIC board and Concrete board.
PMIC_SUPPORT ?= "1"

# Supported devicetree
KERNEL_DEVICETREE = " \
	renesas/r9a07g054l2-smarc.dtb \
"

IMAGE_BOOT_FILES = " \
	bl2_bp-${MACHINE}_pmic.bin \
	bl2_bp-${MACHINE}.bin \
	fip-${MACHINE}_pmic.bin \
	fip-${MACHINE}.bin \
	Flash_Writer_SCIF_RZV2L_SMARC_PMIC_DDR4_2GB_1PCS.mot \
	Flash_Writer_SCIF_RZV2L_SMARC_DDR4_4GB.mot \
"
WIC_INPUT_DEPENDS = "firmware-pack:do_deploy flash-writer:do_deploy"
```

## meta-rzv2l/docs/template/conf/bblayers.conf.sample
```bitbake
# POKY_BBLAYERS_CONF_VERSION is increased each time build/conf/bblayers.conf
# changes incompatibly
POKY_BBLAYERS_CONF_VERSION = "2"

BBPATH = "${TOPDIR}"
BBFILES ?= ""

BBLAYERS ?= " \
  ${TOPDIR}/../meta-gplv2 \
  ${TOPDIR}/../poky/meta \
  ${TOPDIR}/../poky/meta-poky \
  ${TOPDIR}/../poky/meta-yocto-bsp \
  ${TOPDIR}/../meta-renesas/meta-rz-common \
  ${TOPDIR}/../meta-renesas/meta-rzg2l \
  ${TOPDIR}/../meta-renesas/meta-rzv2l \
  ${TOPDIR}/../meta-openembedded/meta-oe \
  ${TOPDIR}/../meta-openembedded/meta-python \
  ${TOPDIR}/../meta-openembedded/meta-multimedia \
  "
```

## meta-rzv2m/conf/layer.conf
```bitbake
# We have a conf and classes directory, add to BBPATH
BBPATH .= ":${LAYERDIR}"

# We have recipes-* directories, add to BBFILES
BBFILES += "${LAYERDIR}/recipes-*/*/*.bb \
            ${LAYERDIR}/recipes-*/*/*.bbappend"

BBFILE_COLLECTIONS += "rzv2m"
BBFILE_PATTERN_rzv2m = "^${LAYERDIR}/"
BBFILE_PRIORITY_rzv2m = "15"

LAYERDEPENDS_rzv2m = "rz-common"
LAYERSERIES_COMPAT_rzv2m = "dunfell"
```

## meta-rzv2m/conf/machine/include/r9a09g011gbg.inc
```bitbake
SOC_FAMILY =. "rzv2m:"
require conf/machine/include/soc-family.inc
LINUXLIBCVERSION = "5.10%"
```

## meta-rzv2m/conf/machine/include/rzv2m-common.inc
```bitbake
require conf/machine/include/${SOC_FAMILY}.inc
require conf/machine/include/rzg2-common.inc

IMAGE_INSTALL_append = " \
	openssh \
	openssh-sshd \
	openssl-bin \
"

RZ_FEATURE_BOOTLOADER = "${@'True' if 'meta-rz-features/meta-rz-bootloaders' in '${BBLAYERS}' else 'False'}"
EXTRA_IMAGEDEPENDS += " ${@oe.utils.conditional('RZ_FEATURE_BOOTLOADER', 'True', ' bootloader', '', d)}"
```

## meta-rzv2m/conf/machine/rzv2m.conf
```bitbake
#@TYPE: Machine
#@NAME: RZV2M machine
#@DESCRIPTION: CSM Solution RZ/V2M Evaluation Board Kit

SOC_FAMILY = "r9a09g011gbg"
require conf/machine/include/rzv2m-common.inc
require conf/machine/include/cip-core.inc

DEFAULTTUNE ?= "cortexa53"

TUNE_CONF ?= "conf/machine/include/tune-cortexa53.inc"
require ${TUNE_CONF}

PREFERRED_PROVIDER_virtual/kernel = "linux-renesas"

UBOOT_CONFIG ??= "rzv2m"
UBOOT_CONFIG[rzv2m] = "r9a09g011gbg_rzv2m_defconfig"

# bootloader
EXTRA_IMAGEDEPENDS_remove = " trusted-firmware-a"

# flash-writer
EXTRA_IMAGEDEPENDS += " flash-writer"

# Supported devicetree
KERNEL_DEVICETREE = " \
	renesas/r9a09g011-v2mevk2.dtb \
"

IMAGE_BOOT_FILES = " \
	B2_intSW.bin \
	${@'loader_1st_128kb.bin loader_2nd_param.bin loader_2nd.bin' if '${RZ_FEATURE_BOOTLOADER}' == 'True' else ''} \
	u-boot_param.bin u-boot.bin \
"
WIC_INPUT_DEPENDS = " \
	flash-writer:do_deploy \
	${@'bootloader:do_deploy' if '${RZ_FEATURE_BOOTLOADER}' == 'True' else ''} \
	u-boot:do_deploy \
"


IMAGE_INSTALL_remove = " optee-client"
```

## meta-rzv2m/conf/machine/rzv2ma.conf
```bitbake
#@TYPE: Machine
#@NAME: RZV2MA machine
#@DESCRIPTION: Shimafuji Electric RZ/V2MA Evaluation Board Kit

SOC_FAMILY = "r9a09g055ma3gbg"
require conf/machine/include/rzv2m-common.inc
require conf/machine/include/cip-core.inc

DEFAULTTUNE ?= "cortexa53"

TUNE_CONF ?= "conf/machine/include/tune-cortexa53.inc"
require ${TUNE_CONF}

PREFERRED_PROVIDER_virtual/kernel = "linux-renesas"

UBOOT_CONFIG ??= "rzv2ma"
UBOOT_CONFIG[rzv2ma] = "r9a09g055ma3gbg_rzv2ma_defconfig"

# bootloader
EXTRA_IMAGEDEPENDS_remove = " trusted-firmware-a"

# flash-writer
EXTRA_IMAGEDEPENDS += " flash-writer"

# Supported devicetree
KERNEL_DEVICETREE = " \
	renesas/r9a09g055-v2maevk2.dtb \
"

IMAGE_BOOT_FILES = " \
        B2_intSW.bin \
        ${@'loader_1st_128kb.bin loader_2nd_param.bin loader_2nd.bin' if '${RZ_FEATURE_BOOTLOADER}' == 'True' else ''} \
        u-boot_param.bin u-boot.bin \
"
WIC_INPUT_DEPENDS = " \
        flash-writer:do_deploy \
        ${@'bootloader:do_deploy' if '${RZ_FEATURE_BOOTLOADER}' == 'True' else ''} \
        u-boot:do_deploy \
"

IMAGE_INSTALL_remove = " optee-client"
```
