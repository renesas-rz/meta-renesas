## meta-rzt2h/conf/machine/include/r9a09g077.inc
```bitbake
SOC_FAMILY =. "rzt2h:"
require conf/machine/include/soc-family.inc
LINUXLIBCVERSION = "5.10%"
```

## meta-rzt2h/conf/machine/rzn2h-dev.conf
```bitbake
#@TYPE: Machine
#@NAME: rzn2h-dev machine
#@DESCRIPTION: RZ/N2H Development Board platform

SOC_FAMILY = "r9a09g087"
require conf/machine/include/${SOC_FAMILY}.inc
require conf/machine/include/rzg2-common.inc
require conf/machine/include/cip-core.inc

DEFAULTTUNE ?= "cortexa55"

TUNE_CONF ?= "conf/machine/include/tune-cortexa55.inc"
require ${TUNE_CONF}

PREFERRED_PROVIDER_virtual/kernel="linux-renesas"


UBOOT_CONFIG ??= "rzn2h-dev"
UBOOT_CONFIG[rzn2h-dev] = "rzn2h-dev_defconfig"

# Supported devicetree
KERNEL_DEVICETREE = " \
	renesas/r9a09g087m44-dev.dtb \
"

IMAGE_BOOT_FILES = " \
	bl2_bp_xspi0-${MACHINE}.bin \
	bl2_bp_xspi1-${MACHINE}.bin \
	bl2_bp_emmc-${MACHINE}.bin \
	bl2_bp_esd-${MACHINE}.bin \
	fip-${MACHINE}.bin \
	bl2_bp_xspi0-${MACHINE}.srec \
	bl2_bp_xspi1-${MACHINE}.srec \
	bl2_bp_emmc-${MACHINE}.srec \
	fip-${MACHINE}.srec \
"

WIC_INPUT_DEPENDS = "trusted-firmware-a:do_deploy"
```

## meta-rzt2h/conf/machine/rzt2h-dev.conf
```bitbake
#@TYPE: Machine
#@NAME: rzt2h-dev machine
#@DESCRIPTION: RZ/T2H Evaluation Board platform

SOC_FAMILY = "r9a09g077"
require conf/machine/include/${SOC_FAMILY}.inc
require conf/machine/include/rzg2-common.inc
require conf/machine/include/cip-core.inc

DEFAULTTUNE ?= "cortexa55"

TUNE_CONF ?= "conf/machine/include/tune-cortexa55.inc"
require ${TUNE_CONF}

PREFERRED_PROVIDER_virtual/kernel="linux-renesas"


UBOOT_CONFIG ??= "rzt2h-dev"
UBOOT_CONFIG[rzt2h-dev] = "rzt2h-dev_defconfig"

# Supported devicetree
KERNEL_DEVICETREE = " \
	renesas/r9a09g077m44-dev.dtb \
"

IMAGE_BOOT_FILES = " \
	bl2_bp_xspi0-${MACHINE}.bin \
	bl2_bp_xspi1-${MACHINE}.bin \
	bl2_bp_emmc-${MACHINE}.bin \
	bl2_bp_esd-${MACHINE}.bin \
	fip-${MACHINE}.bin \
	bl2_bp_xspi0-${MACHINE}.srec \
	bl2_bp_xspi1-${MACHINE}.srec \
	bl2_bp_emmc-${MACHINE}.srec \
	fip-${MACHINE}.srec \
"

WIC_INPUT_DEPENDS = "trusted-firmware-a:do_deploy"
```

## meta-rzv2n/conf/machine/include/r9a09g056.inc
```bitbake
SOC_FAMILY =. "rzv2h:rzv2n:"
require conf/machine/include/soc-family.inc
LINUXLIBCVERSION = "5.10%"

MACHINE_FEATURES_append = " opengles opencl hwh264enc hwh264dec hwh265enc hwh265dec"
```

## meta-rzv2n/conf/machine/rzv2n-dev.conf
```bitbake
#@TYPE: Machine
#@NAME: rzv2n-dev machine
#@DESCRIPTION: RZ/V2N Development Board platform

SOC_FAMILY = "r9a09g056"
require conf/machine/include/rzv2h-common.inc
require conf/machine/include/cip-core.inc

DEFAULTTUNE ?= "cortexa55"

TUNE_CONF ?= "conf/machine/include/tune-cortexa55.inc"
require ${TUNE_CONF}

PREFERRED_PROVIDER_virtual/kernel="linux-renesas"

UBOOT_CONFIG ??= "rzv2n-dev"
UBOOT_CONFIG[rzv2n-dev] = "rzv2n-dev_defconfig"

# flash writer
EXTRA_IMAGEDEPENDS += " flash-writer"

# Supported devicetree
KERNEL_DEVICETREE = " \
	renesas/r9a09g056n44-dev.dtb \
"

IMAGE_INSTALL_remove = " optee-client"

IMAGE_BOOT_FILES = " \
	bl2_bp_spi-${MACHINE}.srec \
	fip-${MACHINE}.srec \
	Flash_Writer_SCIF_RZV2N_DEV_LPDDR4X.mot \
"

WIC_INPUT_DEPENDS = "firmware-pack:do_deploy flash-writer:do_deploy"
```
