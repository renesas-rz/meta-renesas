## meta-rz-bsp/conf/machine/rzn2h-dev.conf
```bitbake
#@TYPE: Machine
#@NAME: rzn2h-dev
#@DESCRIPTION: Reference machine configuration for the RZ/N2H Development Board platform

require conf/machine/include/arm/armv8-2a/tune-cortexa55.inc
require conf/machine/include/rz-common.inc
require conf/machine/include/rzt2h-family.inc

# Trusted Firmware-A configuration
TFA_PLATFORM ?= "n2h"
TFA_BOARD ?= "eval"

# Trusted Firmware-A configuration
PREFERRED_VERSION_trusted-firmware-a ?= "2.10%"
TFA_UBOOT ?= "1"
TFA_BUILD_TARGET ?= "bl2 fip"
BL2_BOOT_TARGET ?= "xspi0 xspi1 emmc esd"

BL2_ADJUST_VMA ?= "0x10100000"
FIP_ADJUST_VMA ?= "0x10100000"

LOADER_ADDR_xspi0	?= "0x40000200"
LOADER_ADDR_xspi1	?= "0x50000200"
LOADER_ADDR_emmc	?= "0x00000400"
LOADER_ADDR_esd	?= "0x00001000"

DEST_ADDR		?= "0x10001000"
PLL0_SSC_CTR_V		?= "0x00010000"
BOOTCPU_FLG		?= "1"
XSPI_CSSCTL_V		?= "0x07FFFFFF"

# U-Boot Configuration
UBOOT_CONFIG ??= "rzn2h-dev"
UBOOT_CONFIG[rzn2h-dev] = "rzn2h-dev_defconfig"
PREFERRED_VERSION_u-boot = "2024.07%"

# Linux kernel configuration
KERNEL_DEVICETREE ?= "renesas/r9a09g087m44-dev.dtb"
IMAGE_BOOT_FILES = " \
	bl2_bp_xspi0-${MACHINE}.bin \
	bl2_bp_xspi1-${MACHINE}.bin \
	bl2_bp_emmc-${MACHINE}.bin \
	bl2_bp_esd-${MACHINE}.bin \
	bl2_bp_xspi0-${MACHINE}.srec \
	bl2_bp_xspi1-${MACHINE}.srec \
	bl2_bp_emmc-${MACHINE}.srec \
	bl2_bp_esd-${MACHINE}.srec \
	fip-${MACHINE}.bin \
	fip-${MACHINE}.srec \
"

# Wic image
WKS_FILE = "rz-image-bootpart-esd.wks"
do_image_wic[depends] += "trusted-firmware-a:do_deploy"
```

## meta-rz-bsp/conf/machine/rzt2h-evk.conf
```bitbake
#@TYPE: Machine
#@NAME: rzt2h-evk
#@DESCRIPTION: Reference machine configuration for the RZ/T2H Evaluation Board Kit

require conf/machine/include/arm/armv8-2a/tune-cortexa55.inc
require conf/machine/include/rz-common.inc
require conf/machine/include/rzt2h-family.inc

# Trusted Firmware-A configuration
TFA_PLATFORM ?= "t2h"
TFA_BOARD ?= "dev_1"

# Trusted Firmware-A configuration
PREFERRED_VERSION_trusted-firmware-a ?= "2.10%"
TFA_UBOOT ?= "1"
TFA_BUILD_TARGET ?= "bl2 fip"
BL2_BOOT_TARGET ?= "xspi0 xspi1 emmc esd"

BL2_ADJUST_VMA ?= "0x10100000"
FIP_ADJUST_VMA ?= "0x10100000"

LOADER_ADDR_xspi0	?= "0x40000200"
LOADER_ADDR_xspi1	?= "0x50000200"
LOADER_ADDR_emmc	?= "0x00000400"
LOADER_ADDR_esd	?= "0x00001000"

DEST_ADDR		?= "0x10001000"
PLL0_SSC_CTR_V		?= "0x00010000"
BOOTCPU_FLG		?= "1"
XSPI_CSSCTL_V		?= "0x07FFFFFF"

# U-Boot Configuration
UBOOT_CONFIG ??= "rzt2h-evk"
UBOOT_CONFIG[rzt2h-evk] = "rzt2h-dev_defconfig"
PREFERRED_VERSION_u-boot = "2024.07%"

# Linux kernel configuration
KERNEL_DEVICETREE ?= " \
	renesas/r9a09g077m44-rzt2h-evk.dtb \
	renesas/r9a09g077m44-rzt2h-evk-cn15-lcdc.dtb \
"

IMAGE_BOOT_FILES = " \
	bl2_bp_xspi0-${MACHINE}.bin \
	bl2_bp_xspi1-${MACHINE}.bin \
	bl2_bp_emmc-${MACHINE}.bin \
	bl2_bp_esd-${MACHINE}.bin \
	bl2_bp_xspi0-${MACHINE}.srec \
	bl2_bp_xspi1-${MACHINE}.srec \
	bl2_bp_emmc-${MACHINE}.srec \
	bl2_bp_esd-${MACHINE}.srec \
	fip-${MACHINE}.bin \
	fip-${MACHINE}.srec \
"

# Wic image
WKS_FILE = "rz-image-bootpart-esd.wks"
do_image_wic[depends] += "trusted-firmware-a:do_deploy"
```

## meta-rz-bsp/conf/machine/rzv2h-evk.conf
```bitbake
#@TYPE: Machine
#@NAME: rzv2h-evk-version1/2 machine
#@DESCRIPTION: RZ/V2H Evaluation Board Kit

require conf/machine/include/rzv2h-family.inc
require conf/machine/include/arm/armv8-2a/tune-cortexa55.inc
require conf/machine/include/rz-common.inc

SERIAL_CONSOLES ?= "115200;ttySC0"
PREFERRED_VERSION_trusted-firmware-a ?= "2.10%"
TFA_PLATFORM ?= "v2h"
TFA_BOARD ?= "evk_1"
TFA_UBOOT ?= "1"
TFA_BUILD_TARGET ?= "bl2 fip"
BL2_BOOT_TARGET ?= "spi mmc esd"
EXTRA_IMAGEDEPENDS += " firmware-pack"

BL2_BASE_ADDR ?= "0x08103000"
BL2_ADJUST_VMA ?= "0x08101E00"
FIP_ADJUST_VMA ?= "0x0"

# U-Boot Configuration
PREFERRED_VERSION_u-boot ?= "2024.07%"
UBOOT_CONFIG ??= "rzv2h-evk-ver1"
UBOOT_CONFIG[rzv2h-evk-ver1] = "rzv2h-evk-ver1_defconfig"

# flash writer
EXTRA_IMAGEDEPENDS += " flash-writer"

# firmware pack
EXTRA_IMAGEDEPENDS += " firmware-pack"

# Supported devicetree
KERNEL_DEVICETREE = " \
	renesas/r9a09g057h44-rzv2h-evk.dtb \
	renesas/r9a09g057h44-rzv2h-evk-cn15-sd.dtb \
	renesas/r9a09g057h44-rzv2h-evk-cn15-emmc.dtb \
"

IMAGE_BOOT_FILES = " \
	bl2_bp_spi-${MACHINE}.bin \
	bl2_bp_spi-${MACHINE}.srec \
	bl2_bp_mmc-${MACHINE}.bin \
	bl2_bp_mmc-${MACHINE}.srec \
	fip-${MACHINE}.bin \
	fip-${MACHINE}.srec \
	Flash_Writer_SCIF_RZV2H_DEV_INTERNAL_MEMORY.mot \
"

# Wic image
WKS_FILE = "rz-image-bootpart-esd.wks"
do_image_wic[depends] += "firmware-pack:do_deploy"
```

## meta-rz-bsp/conf/machine/rzv2n-evk.conf
```bitbake
#@TYPE: Machine
#@NAME: rzv2n-evk-version1/2 machine
#@DESCRIPTION: RZ/V2N Evaluation Board Kit

require conf/machine/include/rzv2n-family.inc
require conf/machine/include/arm/armv8-2a/tune-cortexa55.inc
require conf/machine/include/rz-common.inc

SERIAL_CONSOLES ?= "115200;ttySC0"
PREFERRED_VERSION_trusted-firmware-a ?= "2.10%"
TFA_PLATFORM ?= "v2n"
TFA_BOARD ?= "evk_1"
TFA_UBOOT ?= "1"
TFA_BUILD_TARGET ?= "bl2 fip"
BL2_BOOT_TARGET ?= "spi mmc esd"
EXTRA_IMAGEDEPENDS += " firmware-pack"

BL2_BASE_ADDR ?= "0x08103000"
BL2_ADJUST_VMA ?= "0x08101E00"
FIP_ADJUST_VMA ?= "0x0"

# U-Boot Configuration
PREFERRED_VERSION_u-boot ?= "2024.07%"
UBOOT_CONFIG ??= "rzv2n-evk"
UBOOT_CONFIG[rzv2n-evk] = "rzv2n-evk_defconfig"

# flash writer
EXTRA_IMAGEDEPENDS += " flash-writer"

# firmware pack
EXTRA_IMAGEDEPENDS += " firmware-pack"

# Supported devicetree
KERNEL_DEVICETREE = " \
	renesas/r9a09g056n48-rzv2n-evk.dtb \
	renesas/r9a09g056n48-rzv2n-evk-cn15-sd.dtb \
	renesas/r9a09g056n48-rzv2n-evk-cn15-emmc.dtb \
"


IMAGE_BOOT_FILES = " \
	bl2_bp_spi-${MACHINE}.bin \
	bl2_bp_spi-${MACHINE}.srec \
	bl2_bp_mmc-${MACHINE}.bin \
	bl2_bp_mmc-${MACHINE}.srec \
	fip-${MACHINE}.bin \
	fip-${MACHINE}.srec \
	Flash_Writer_SCIF_RZV2N_DEV_LPDDR4X.mot \
"

# Wic image
WKS_FILE = "rz-image-bootpart-esd.wks"
do_image_wic[depends] += "firmware-pack:do_deploy"
```

## meta-rz-bsp/conf/machine/smarc-rzg3l.conf
```bitbake
#@TYPE: Machine
#@NAME: smarc-rzg3l
#@DESCRIPTION: Reference machine configuration for the RZ/G3L Smarc Board

require conf/machine/include/arm/armv8-2a/tune-cortexa55.inc
require conf/machine/include/rz-common.inc
require conf/machine/include/rzg3l-family.inc

# Machine configuration
MACHINE_FEATURES:append = " alsa ext2 pci serial usbgadget usbhost can"

# Trusted Firmware-A configuration
PREFERRED_VERSION_trusted-firmware-a ?= "2.10%"
TFA_PLATFORM ?= "g3l"
TFA_BOARD ?= "smarc"
TFA_UBOOT ?= "1"
TFA_BUILD_TARGET ?= "bl2 fip"
BL2_BOOT_TARGET ?= "spi mmc esd"
BL2_BASE_ADDR ?= "0x23000"
BL2_ADJUST_VMA ?= "0x21E00"
FIP_ADJUST_VMA ?= "0x0000"
EXTRA_IMAGEDEPENDS += " firmware-pack"

# U-Boot Configuration
UBOOT_CONFIG ??= "smarc-rzg3l"
UBOOT_CONFIG[smarc-rzg3l] = "smarc-rzg3l_defconfig"
PREFERRED_VERSION_u-boot ?= "2024.07%"

# Linux kernel configuration
KERNEL_IMAGETYPE ?= "Image"
KERNEL_DEVICETREE ?= "renesas/r9a08g046l48-smarc.dtb"

PREFERRED_PROVIDER_virtual/kernel ?= "linux-renesas"

IMAGE_BOOT_FILES = " \
	bl2_bp_spi-${MACHINE}.bin \
	bl2_bp_spi-${MACHINE}.srec \
	bl2_bp_mmc-${MACHINE}.bin \
	bl2_bp_mmc-${MACHINE}.srec \
	bl2_bp_esd-${MACHINE}.bin \
	bl2_bp_esd-${MACHINE}.srec \
	fip-${MACHINE}.bin \
	fip-${MACHINE}.bin \
	fip-${MACHINE}.srec \
	Flash_Writer_SCIF_RZG3L_SMARC_LPDDR4.mot \
"
do_image_wic[depends] += "firmware-pack:do_deploy flash-writer:do_deploy"
```

## meta-rz-bsp/conf/machine/smarc-rzg3s.conf
```bitbake
#@TYPE: Machine
#@NAME: smarc-rzg3s machine
#@DESCRIPTION: RZ/G3S SMARC EVK Board platform

require conf/machine/include/arm/armv8-2a/tune-cortexa55.inc
require conf/machine/include/rz-common.inc
require conf/machine/include/rzg3s-family.inc

SERIAL_CONSOLES ?= "115200;ttySC3"
# Trusted Firmware-A configuration
PREFERRED_VERSION_trusted-firmware-a ?= "2.7%"
TFA_PLATFORM ?= "g3s"
TFA_BOARD ?= "smarc PLAT_SYSTEM_SUSPEND=vbat"
TFA_UBOOT ?= "1"
TFA_BUILD_TARGET ?= "bl2 bl31 fip"
BL2_BOOT_TARGET ?= "spi mmc esd"
BL2_ADJUST_VMA ?= "0xA1E00"
FIP_ADJUST_VMA ?= "0x0000"
BL2_LOAD_ADDRESS ?= "0xA3000"

# U-Boot Configuration
UBOOT_CONFIG ??= "smarc-rzg3s"
UBOOT_CONFIG[smarc-rzg3s] = "smarc-rzg3s_defconfig"
PREFERRED_VERSION_u-boot = "2021.10%"

# Supported devicetree
KERNEL_DEVICETREE ?= " \
	renesas/r9a08g045s33-smarc.dtb \
"

# Wic image
WKS_FILE = "rz-image-bootpart-esd.wks"

IMAGE_BOOT_FILES = " \
	bl2_bp_spi-${MACHINE}.bin \
	bl2_bp_mmc-${MACHINE}.bin \
	bl2_bp_esd-${MACHINE}.bin \
	fip-${MACHINE}.bin \
	bl2_bp_spi-${MACHINE}.srec \
	bl2_bp_mmc-${MACHINE}.srec \
	bl2_bp_esd-${MACHINE}.srec \
	fip-${MACHINE}.srec \
	FlashWriter-${MACHINE}.mot \
"
do_image_wic[depends] += "firmware-pack:do_deploy flash-writer:do_deploy"
```

## meta-rzg3s/conf/machine/rzg3s-dev.conf
```bitbake
#@TYPE: Machine
#@NAME: rzg3s-dev machine
#@DESCRIPTION: RZ/G3S Development Board platform

SOC_FAMILY = "r9a08g045"
require conf/machine/include/${SOC_FAMILY}.inc
require conf/machine/include/cip-core.inc

DEFAULTTUNE ?= "cortexa55"

TUNE_CONF ?= "conf/machine/include/tune-cortexa55.inc"
require ${TUNE_CONF}

PREFERRED_PROVIDER_virtual/kernel="linux-renesas"

UBOOT_CONFIG ??= "rzg3s-dev"
UBOOT_CONFIG[rzg3s-dev] = "rzg3s-dev_defconfig"

# Add flash writer and firmware-pack
EXTRA_IMAGEDEPENDS += " flash-writer firmware-pack"

# Supported devicetree
KERNEL_DEVICETREE = " \
	renesas/r9a08g045s31-dev.dtb \
	renesas/r9a08g045s33-dev.dtb \
"

IMAGE_BOOT_FILES = " \
	bl2_bp_spi-${MACHINE}.bin \
	bl2_bp_emmc-${MACHINE}.bin \
	bl2_bp_esd-${MACHINE}.bin \
	fip-${MACHINE}.bin \
	bl2_bp_spi-${MACHINE}.srec \
	bl2_bp_emmc-${MACHINE}.srec \
	bl2_bp_esd-${MACHINE}.srec \
	fip-${MACHINE}.srec \
	FlashWriter-${MACHINE}.mot \
"
WIC_INPUT_DEPENDS = "firmware-pack:do_deploy flash-writer:do_deploy"
```

## meta-rzg3s/conf/machine/smarc-rzg3s.conf
```bitbake
#@TYPE: Machine
#@NAME: smarc-rzg3s machine
#@DESCRIPTION: RZ/G3S SMARC EVK Board platform

SOC_FAMILY = "r9a08g045"
require conf/machine/include/${SOC_FAMILY}.inc
require conf/machine/include/cip-core.inc

DEFAULTTUNE ?= "cortexa55"

TUNE_CONF ?= "conf/machine/include/tune-cortexa55.inc"
require ${TUNE_CONF}

PREFERRED_PROVIDER_virtual/kernel="linux-renesas"

UBOOT_CONFIG ??= "smarc-rzg3s"
UBOOT_CONFIG[smarc-rzg3s] = "smarc-rzg3s_defconfig"

# Add flash writer and firmware-pack
EXTRA_IMAGEDEPENDS += " flash-writer firmware-pack"

# Supported devicetree
KERNEL_DEVICETREE = " \
	renesas/r9a08g045s33-smarc.dtb \
"

IMAGE_BOOT_FILES = " \
	bl2_bp_spi-${MACHINE}.bin \
	bl2_bp_emmc-${MACHINE}.bin \
	bl2_bp_esd-${MACHINE}.bin \
	fip-${MACHINE}.bin \
	bl2_bp_spi-${MACHINE}.srec \
	bl2_bp_emmc-${MACHINE}.srec \
	bl2_bp_esd-${MACHINE}.srec \
	fip-${MACHINE}.srec \
	FlashWriter-${MACHINE}.mot \
"
WIC_INPUT_DEPENDS = "firmware-pack:do_deploy flash-writer:do_deploy"
```
