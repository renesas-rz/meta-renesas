## Kconfig
```kconfig
mainmenu "Renesas RZ Configuration"

config KAS_BUILD_SYSTEM
	string
	default "openembedded"

config KAS_INCLUDE_BASE
	string
	default "kas/base.yml"

config FAMILY_G2L
bool

config FAMILY_G3E
bool

config FAMILY_G3S
bool

config FAMILY_V2H
bool

menu "Machines"
choice
	prompt "Select machine:"
	default MACHINE_SMARC-RZG2L

	config MACHINE_SMARC-RZG2L
	bool "smarc-rzg2l"
	select FAMILY_G2L
	help
		Select the Renesas RZ/G2L reference platform.

	config KAS_INCLUDE_MACHINE_SMARC-RZG2L
	string
	depends on MACHINE_SMARC-RZG2L
	default "kas/machines/smarc-rzg2l.yml"

	config MACHINE_SMARC-RZG2LC
	bool "smarc-rzg2lc"
	select FAMILY_G2L
	help
		Select the Renesas RZ/G2LC reference platform.

	config KAS_INCLUDE_MACHINE_SMARC-RZG2LC
	string
	depends on MACHINE_SMARC-RZG2LC
	default "kas/machines/smarc-rzg2lc.yml"

	config MACHINE_SMARC-RZG2UL
	bool "smarc-rzg2ul"
	select FAMILY_G2L
	help
		Select the Renesas RZ/G2UL reference platform.

	config KAS_INCLUDE_MACHINE_SMARC-RZG2UL
	string
	depends on MACHINE_SMARC-RZG2UL
	default "kas/machines/smarc-rzg2ul.yml"

	config MACHINE_SMARC-RZV2L
	bool "smarc-rzv2l"
	select FAMILY_G2L
	help
		Select the Renesas RZ/V2L reference platform.

	config KAS_INCLUDE_MACHINE_SMARC-RZV2L
	string
	depends on MACHINE_SMARC-RZV2L
	default "kas/machines/smarc-rzv2l.yml"

	config MACHINE_RZV2H-EVK
	bool "rzv2h-evk"
	select FAMILY_V2H
	help
		Select the Renesas RZ/V2H reference platform.

	config KAS_INCLUDE_MACHINE_RZV2H-EVK
	string
	depends on MACHINE_RZV2H-EVK
	default "kas/machines/rzv2h-evk.yml"

	config MACHINE_RZG3E-DEV
	bool "rzg3e-dev"
	select FAMILY_G3E
	help
		Select the Renesas RZ/G3E reference platform.

	config KAS_INCLUDE_MACHINE_RZG3E-DEV
	string
	depends on MACHINE_RZG3E-DEV
	default "kas/machines/rzg3e-dev.yml"

	config MACHINE_SMARC-RZG3E
	bool "smarc-rzg3e"
	select FAMILY_G3E
	help
		Select the Renesas RZ/G3E reference platform.

	config KAS_INCLUDE_MACHINE_SMARC-RZG3E
	string
	depends on MACHINE_SMARC-RZG3E
	default "kas/machines/smarc-rzg3e.yml"

	config MACHINE_SMARC-RZG3S
	bool "smarc-rzg3s"
	select FAMILY_G3S
	help
		Select the Renesas RZ/G3S reference platform

	config KAS_INCLUDE_MACHINE_SMARC-RZG3S
	string
	depends on MACHINE_SMARC-RZG3S
	default "kas/machines/smarc-rzg3s.yml"

endchoice
endmenu

menu "Targets"
choice
	prompt "Select target:"
	default IMAGE_CORE_IMAGE_MINIMAL

	config IMAGE_CORE_IMAGE_MINIMAL
	bool "core-image-minimal"
	help
		A small image just capable of allowing a device to boot.

	config KAS_INCLUDE_IMAGE_CORE_IMAGE_MINIMAL
	string
	depends on IMAGE_CORE_IMAGE_MINIMAL
	default "kas/images/core-image-minimal.yml"

	config IMAGE_CORE_IMAGE_WESTON
	bool "core-image-weston"
	help
		A very basic Wayland image with a terminal.
		This image provides the Wayland protocol libraries and the reference Weston compositor.
		It also contains GStreamer 1.0 framework, tools, and multimedia support packages.

	config KAS_INCLUDE_IMAGE_CORE_IMAGE_WESTON
	string
	depends on IMAGE_CORE_IMAGE_WESTON
	default "kas/images/core-image-weston.yml"

endchoice
endmenu

menu "Features"
	config FEATURE_GRAPHICS
	bool "Graphics"
	default n
	help
		Enable support for the GPU using meta-rz-graphics.
		Note that the meta-rz-features/meta-rz-graphics directory should be extracted to the working directory.

	config KAS_INCLUDE_FEATURE_GRAPHICS
	string
	depends on FEATURE_GRAPHICS
	default "kas/features/graphics.yml"

	config FEATURE_CODECS
	bool "Codecs"
	default n
	help
		Enable support for the Renesas codec libraries using meta-rz-multimedia.
		Note that the meta-rz-features/meta-rz-codecs directory should be extracted to the working directory.

	config KAS_INCLUDE_FEATURE_CODECS
	string
	depends on FEATURE_CODECS
	default "kas/features/codecs.yml"
endmenu

menu "Misc"
choice
	prompt "Select kernel version"
	default KERNEL_V6_1

	config KERNEL_V6_1
	bool "Kernel version 6.1"
	help
		Use kernel 6.1 version for build.

	config KERNEL_V6_12
	bool "Kernel version 6.12"
	help
		Use kernel 6.12 version for build.

endchoice

	config KAS_INCLUDE_KERNEL_VERSION
	string
	default "kas/misc/kernel-v6.1.yml" if KERNEL_V6_1
	default "kas/misc/kernel-v6.12.yml" if KERNEL_V6_12

	config KERNEL_REALTIME
	bool "Kernel-realtime"
	default n
	help
		Choose realtime characteristic of Linux kernel to build with.

	config KAS_INCLUDE_KERNEL_REALTIME
	string
	depends on KERNEL_REALTIME
	default "kas/misc/kernel-rt.yml"

	config DOCKER
	bool "Docker"
	depends on !KERNEL_REALTIME
	default n
	help
		Enable the Docker Engine to build with.

	config KAS_INCLUDE_DOCKER
	string
	depends on DOCKER
	default "kas/misc/docker.yml"
endmenu
```

## meta-rz-boards/conf/machine/smarc-rzg2ul.conf
```bitbake
#@TYPE: Machine
#@NAME: smarc-rzg2ul machine
#@DESCRIPTION: RZ/G2UL SMARC platform

require conf/machine/include/arm/armv8-2a/tune-cortexa55.inc
require conf/machine/include/rz-common.inc
require conf/machine/include/rzg2l-family.inc

# Trusted Firmware-A configuration
PREFERRED_VERSION_trusted-firmware-a ?= "2.9%"
TFA_PLATFORM ?= "g2ul"
TFA_BOARD ?= "g2ul_smarc SOC_TYPE=1 SPI_FLASH=AT25QL128A"
TFA_UBOOT ?= "1"
TFA_BUILD_TARGET ?= "bl2 bl31 fip"
BL2_BOOT_TARGET ?= "spi mmc esd"
BL2_ADJUST_VMA ?= "0x00011E00"
FIP_ADJUST_VMA ?= "0x0000"

# U-Boot Configuration
UBOOT_CONFIG ??= "smarc-rzg2ul"
UBOOT_CONFIG[smarc-rzg2ul] = "smarc-rzg2ul_defconfig"
PREFERRED_VERSION_u-boot = "v2021.10%"

# Flash Writer configuration
FLASH_WRITER_BOARD ?= "RZG2UL_SMARC"

# Supported devicetree
KERNEL_IMAGETYPE ?= "Image"
KERNEL_DEVICETREE = " \
	renesas/r9a07g043u11-smarc.dtb \
"

IMAGE_BOOT_FILES = " \
	bl2_bp_spi-${MACHINE}.bin \
	bl2_bp_mmc-${MACHINE}.bin \
	fip-${MACHINE}.bin \
	bl2_bp_spi-${MACHINE}.srec \
	bl2_bp_mmc-${MACHINE}.srec \
	fip-${MACHINE}.srec \
	Flash_Writer_SCIF_RZG2UL_SMARC_DDR4_1GB_1PCS.mot \
"
WIC_INPUT_DEPENDS = "firmware-pack:do_deploy flash-writer:do_deploy"
```

## meta-rz-bsp/conf/distro/rz-bsp.conf
```bitbake
require conf/distro/poky.conf

DISTRO = "rz-bsp"
DISTROOVERRIDES = "poky:rz-bsp"

# Override these in poky based distros
DISTRO_FEATURES:append = " pam can"
DISTRO_FEATURES:remove = " x11"

MACHINE_ESSENTIAL_EXTRA_RDEPENDS += "kernel-image kernel-devicetree"

PREFERRED_VERSION_u-boot ?= "2023.10%"
PREFERRED_PROVIDER_virtual/kernel ?= "linux-renesas"
PREFERRED_VERSION_linux-renesas ?= "6.1%"
PREFERRED_VERSION_linux-libc-headers ?= "6.1%"

SANITY_TESTED_DISTROS ?= " \
	ubuntu-22.04 \n \
	"

# Using Systemd as Initialization Manager
INIT_MANAGER = "systemd"

# Using systemd-journald without a traditional syslog daemon
VIRTUAL-RUNTIME_syslog = ""
VIRTUAL-RUNTIME_base-utils-syslog = ""
```

## meta-rz-bsp/conf/machine/hihope-rzg2h.conf
```bitbake
#@TYPE: Machine
#@NAME: hihope-rzg2h
#@DESCRIPTION: Reference machine configuration for the Hoperun Technology HiHope RZ/G2H platform (hihope-rzg2h)

require conf/machine/include/arm/armv8a/tune-cortexa57-cortexa53.inc
require conf/machine/include/rz-common.inc
require conf/machine/include/rzg2h-family.inc

# Machine configuration
MACHINE_FEATURES:append = " alsa ext2 pci serial usbgadget usbhost can"

SERIAL_CONSOLES ?= "115200;ttySC0"

# Trusted Firmware-A configuration
PREFERRED_VERSION_trusted-firmware-a ?= "2.9%"
TFA_PLATFORM ?= "rzg"
TFA_BUILD_TARGET ?= "bl2 bl31"

# U-Boot Configuration
UBOOT_CONFIG ??= "hihope-rzg2h"
UBOOT_CONFIG[hihope-rzg2h] = "hihope_rzg2_defconfig"
PREFERRED_VERSION_u-boot = "2021.10%"

# flash writer
EXTRA_IMAGEDEPENDS += " flash-writer"

# Supported devicetree
KERNEL_DEVICETREE ?= " \
	renesas/r8a774e1-hihope-rzg2h.dtb \
	renesas/r8a774e1-hihope-rzg2h-ex.dtb \
	renesas/r8a774e1-hihope-rzg2h-ex-idk-1110wr.dtb \
	renesas/r8a774e1-hihope-rzg2h-ex-mipi-2.1.dtb \
	renesas/r8a774e1-hihope-rzg2h-ex-mipi-2.4.dtb \
"

IMAGE_FSTYPES:remove = "wic.gz wic.bmap"
```

## meta-rz-bsp/conf/machine/hihope-rzg2n.conf
```bitbake
#@TYPE: Machine
#@NAME: hihope-rzg2n machine
#@DESCRIPTION: Hoperun Technology HiHope RZ/G2N platform (hihope-rzg2n)

require conf/machine/include/arm/armv8a/tune-cortexa57.inc
require conf/machine/include/rz-common.inc
require conf/machine/include/rzg2h-family.inc

# Machine configuration
MACHINE_FEATURES:append = " alsa ext2 pci serial usbgadget usbhost can"

SERIAL_CONSOLES ?= "115200;ttySC0"

# Trusted Firmware-A configuration
PREFERRED_VERSION_trusted-firmware-a ?= "2.9%"
TFA_PLATFORM ?= "rzg"
TFA_BUILD_TARGET ?= "bl2 bl31"

# U-Boot Configuration
UBOOT_CONFIG ??= "hihope-rzg2n"
UBOOT_CONFIG[hihope-rzg2n] = "hihope_rzg2_defconfig"
PREFERRED_VERSION_u-boot = "2021.10%"

# flash writer
EXTRA_IMAGEDEPENDS += " flash-writer"

# Supported devicetree
KERNEL_DEVICETREE ?= " \
	renesas/r8a774b1-hihope-rzg2n.dtb \
	renesas/r8a774b1-hihope-rzg2n-ex.dtb \
	renesas/r8a774b1-hihope-rzg2n-ex-idk-1110wr.dtb \
	renesas/r8a774b1-hihope-rzg2n-ex-mipi-2.1.dtb \
	renesas/r8a774b1-hihope-rzg2n-ex-mipi-2.4.dtb \
"

IMAGE_BOOT_FILES = " \
	bootparam_sa0.bin \
	bl2-${MACHINE}.bin \
	cert_header_sa6.bin \
	bl31-${MACHINE}.bin \
	u-boot-${MACHINE}.bin \
	bootparam_sa0.srec \
	bl2-${MACHINE}.srec \
	cert_header_sa6.srec \
	bl31-${MACHINE}.srec \
	u-boot-elf-${MACHINE}.srec \
	AArch64_Flash_writer_SCIF_DUMMY_CERT_E6300400_hihope.mot \
"

IMAGE_FSTYPES:remove = "wic.gz wic.bmap"
```

## meta-rz-bsp/conf/machine/include/ecc-control.inc
```bitbake
# =========================================================
# ECC Control Configuration for Renesas RZ/G2 Series
# Support: G2N, G2H
# =========================================================

def machine_to_soc(machine):
    mapping = {
        'hihope-rzg2n': 'r8a774b1',
        'hihope-rzg2h': 'r8a774e1',
    }
    return mapping.get(machine, machine)

# =========================================================
# Function: Check ECC mode compatibility per SoC
# Return:
#   0 = disable / partial
#   1 = Full (Dual)
#   2 = Full (Single)
# =========================================================
def check_ecc_mode(d):
    machine = d.getVar("MACHINE")
    soc = machine_to_soc(machine)
    mode = d.getVar("ECC_MODE")

    if d.getVar("USE_ECC") == '1':
        if mode == 'Full':
            if soc in ['r8a774b1']:
                return '2'
            if soc in ['r8a774e1']:
                return '1'

        if mode == 'Full Dual':
            if soc in ['r8a774e1']:
                return '1'
            bb.fatal("\nSelect wrong ECC Full Mode for ECC_MODE.\
                      \nSoC %s not support 'Full Dual'" % soc)

        if mode == 'Full Single':
            return '2'

    return '0'

ECC="${@'1' if 'ecc' in '${MACHINE_FEATURES}' else '0'}"
USE_ECC="${@'1' if '${ECC}' == '1' else '0'}"

ECC_FULL="${@check_ecc_mode(d)}"
```

## meta-rz-bsp/conf/machine/include/rz-common.inc
```bitbake
IMAGE_FSTYPES:append = " tar.gz tar.bz2 ext4 wic.gz wic.bmap"
WKS_FILE ?= "rz-image-bootpart-mmc.wks"
WICVARS:append = " FIP_WIC_OFFSET"
```

## meta-rz-bsp/conf/machine/include/rzg2h-family.inc
```bitbake
require conf/machine/include/soc-family.inc
require conf/machine/include/ecc-control.inc

SOC_FAMILY = "rzg2h-family"

# Machine configuration
MACHINE_FEATURES = "opengles opencl usb3"

# Linux kernel configuration
PREFERRED_PROVIDER_virtual/kernel ?= "linux-renesas"
PREFERRED_VERSION_linux-renesas ?= "6.12%"
KERNEL_IMAGETYPE ?= "Image"

# U-boot configuration
EXTRA_IMAGEDEPENDS += " u-boot"

# Configuration for ARM Trusted Firmware
EXTRA_IMAGEDEPENDS += " trusted-firmware-a"

# flash writer
EXTRA_IMAGEDEPENDS += " flash-writer"
```

## meta-rz-bsp/conf/machine/include/rzg2l-family.inc
```bitbake
require conf/machine/include/soc-family.inc
SOC_FAMILY = "rzg2l-family:mali-family"

# Machine configuration
MACHINE_FEATURES = "opengles opencl"

# Configuration for ARM Trusted Firmware
EXTRA_IMAGEDEPENDS += " trusted-firmware-a"

# flash writer
EXTRA_IMAGEDEPENDS += " flash-writer"

# Firmware-pack
EXTRA_IMAGEDEPENDS += " firmware-pack"

# Linux kernel configuration
PREFERRED_PROVIDER_virtual/kernel ?= "linux-renesas"
KERNEL_IMAGETYPE ?= "Image"

# Wic image offset
FIP_WIC_OFFSET = "--offset 256s"

# Update default TUNE_FEATURES support for this SoCs
TUNE_FEATURES = "aarch64 cortexa55"

# ECC support
ECC_FLAGS = "${@oe.utils.conditional("ECC_MODE", "ENABLE", " DDR_ECC_ENABLE=1 ", "",d)}"
ECC_FLAGS += "${@oe.utils.conditional("ECC_MODE", "ERR_DETECT", " DDR_ECC_ENABLE=1 DDR_ECC_DETECT=1 ", "",d)}"
ECC_FLAGS += "${@oe.utils.conditional("ECC_MODE", "ERR_DETECT_CORRECT", " DDR_ECC_ENABLE=1 DDR_ECC_DETECT_CORRECT=1 ", "",d)}"
```

## meta-rz-bsp/conf/machine/include/rzg3e-family.inc
```bitbake
require conf/machine/include/soc-family.inc
SOC_FAMILY = "rzg3e-family:mali-family"

MACHINE_FEATURES = "opengles opencl mali-g52"

# Linux kernel configuration
PREFERRED_PROVIDER_virtual/kernel ?= "linux-renesas"
KERNEL_IMAGETYPE ?= "Image"

# flash writer
EXTRA_IMAGEDEPENDS += " flash-writer"

# Wic image offset
FIP_WIC_OFFSET = "--offset 768s"

# Update default TUNE_FEATURES support for this SoCs
TUNE_FEATURES = "aarch64 cortexa55"
```

## meta-rz-bsp/conf/machine/include/rzg3l-family.inc
```bitbake
require conf/machine/include/soc-family.inc
SOC_FAMILY = "rzg3l-family:mali-family"

MACHINE_FEATURES = "opengles opencl mali-g31 hwh264dec hwh264enc"

# Linux kernel configuration
PREFERRED_PROVIDER_virtual/kernel ?= "linux-renesas"
PREFERRED_VERSION_linux-renesas ?= "6.12%"
KERNEL_IMAGETYPE ?= "Image"

# Wic image offset
FIP_WIC_OFFSET = "--offset 768s"
```

## meta-rz-bsp/conf/machine/include/rzg3s-family.inc
```bitbake
require conf/machine/include/soc-family.inc
SOC_FAMILY = "rzg3s-family"

# Configuration for ARM Trusted Firmware
EXTRA_IMAGEDEPENDS += " trusted-firmware-a"

# flash writer
EXTRA_IMAGEDEPENDS += " flash-writer"

# Linux kernel configuration
PREFERRED_PROVIDER_virtual/kernel ?= "linux-renesas"
KERNEL_IMAGETYPE ?= "Image"

# Wic image offset
FIP_WIC_OFFSET = "--offset 768s"

# Update default TUNE_FEATURES support for this SoCs
TUNE_FEATURES = "aarch64 cortexa55"
```

## meta-rz-bsp/conf/machine/include/rzt2h-family.inc
```bitbake
require conf/machine/include/soc-family.inc
SOC_FAMILY = "rzt2h-family"

# Configuration for ARM Trusted Firmware

# Trusted Firmware-A configuration
EXTRA_IMAGEDEPENDS += " trusted-firmware-a"

# flash writer
EXTRA_IMAGEDEPENDS += " flash-writer"

# Firmware-pack
EXTRA_IMAGEDEPENDS += " firmware-pack"

# Linux kernel configuration
PREFERRED_PROVIDER_virtual/kernel ?= "linux-renesas"
KERNEL_IMAGETYPE ?= "Image"

# Wic image offset
FIP_WIC_OFFSET = "--offset 768s"

# Update default TUNE_FEATURES support for this SoCs
TUNE_FEATURES = "aarch64 cortexa55"
```

## meta-rz-bsp/conf/machine/include/rzv2h-family.inc
```bitbake
require conf/machine/include/soc-family.inc
SOC_FAMILY = "rzv2h-family:mali-family"

MACHINE_FEATURES = "opengles opencl mali-g31 hwh264dec hwh264enc hwh265dec hwh265enc"

# Linux kernel configuration
PREFERRED_PROVIDER_virtual/kernel ?= "linux-renesas"
KERNEL_IMAGETYPE ?= "Image"

# Wic image offset
FIP_WIC_OFFSET = "--offset 768s"
```

## meta-rz-bsp/conf/machine/include/rzv2n-family.inc
```bitbake
require conf/machine/include/soc-family.inc
SOC_FAMILY = "rzv2n-family:mali-family"

MACHINE_FEATURES = "opengles opencl mali-g31"

# Linux kernel configuration
PREFERRED_PROVIDER_virtual/kernel ?= "linux-renesas"
KERNEL_IMAGETYPE ?= "Image"

# Wic image offset
FIP_WIC_OFFSET = "--offset 768s"
```
