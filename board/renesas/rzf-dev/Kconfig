## board/renesas/rzf-dev/Kconfig
```kconfig
if TARGET_RZF_DEV

config SYS_CPU
	default "rzfive"

config SYS_BOARD
	default "rzf-dev"

config SYS_VENDOR
	default "renesas"

config SYS_SOC
	default "rzmpu"

config SYS_CONFIG_NAME
	default "rzf-dev"

config ENV_SIZE
	default 0x2000 if ENV_IS_IN_SPI_FLASH

config ENV_OFFSET
	default 0x140000 if ENV_IS_IN_SPI_FLASH

config SPL_TEXT_BASE
	default 0x00012000

config SPL_OPENSBI_LOAD_ADDR
	default 0x44000000

config BOARD_SPECIFIC_OPTIONS # dummy
	def_bool y
	select RISCV_NDS
	select SUPPORT_SPL


config DEBUG_RZF_FPGA
	bool "FPGA DEBUG option"
	default n
	help
		DEBUG Flag on FPGA Board

config DEBUG_OPENSBI
	bool "debug OpenSBI"
	default n
	depends on CMD_SBI

endif

if TARGET_SMARC_RZF

config SYS_CPU
	default "rzfive"

config SYS_BOARD
	default "rzf-dev"

config SYS_VENDOR
	default "renesas"

config SYS_SOC
	default "rzmpu"

config SYS_CONFIG_NAME
	default "smarc-rzf"

config ENV_SIZE
	default 0x2000 if ENV_IS_IN_SPI_FLASH

config ENV_OFFSET
	default 0x140000 if ENV_IS_IN_SPI_FLASH

config SPL_TEXT_BASE
	default 0x00012000

config SPL_OPENSBI_LOAD_ADDR
	default 0x44000000

config BOARD_SPECIFIC_OPTIONS # dummy
	def_bool y
	select RISCV_NDS
	select SUPPORT_SPL


config DEBUG_RZF_FPGA
	bool "FPGA DEBUG option"
	default n
	help
		DEBUG Flag on FPGA Board

config DEBUG_OPENSBI
	bool "debug OpenSBI"
	default n
	depends on CMD_SBI

endif
```

## board/renesas/rzg2l-dev/Kconfig
```kconfig
if TARGET_RZG2L_DEV

config SYS_SOC
	default "rmobile"

config SYS_BOARD
	default "rzg2l-dev"

config SYS_VENDOR
	default "renesas"

config SYS_CONFIG_NAME
	default "rzg2l-dev"

endif

if TARGET_SMARC_RZG2L

config SYS_SOC
	default "rmobile"

config SYS_BOARD
	default "rzg2l-dev"

config SYS_VENDOR
	default "renesas"

config SYS_CONFIG_NAME
	default "smarc-rzg2l"

endif
```

## board/renesas/rzg2lc-dev/Kconfig
```kconfig
if TARGET_RZG2LC_DEV

config SYS_SOC
	default "rmobile"

config SYS_BOARD
	default "rzg2lc-dev"

config SYS_VENDOR
	default "renesas"

config SYS_CONFIG_NAME
	default "rzg2lc-dev"

endif

if TARGET_SMARC_RZG2LC

config SYS_SOC
	default "rmobile"

config SYS_BOARD
	default "rzg2lc-dev"

config SYS_VENDOR
	default "renesas"

config SYS_CONFIG_NAME
	default "smarc-rzg2lc"

endif
```

## board/renesas/rzg2ul-dev/Kconfig
```kconfig
if TARGET_RZG2UL_TYPE1_DEV || TARGET_RZG2UL_TYPE1_DDR3L_DEV || TARGET_RZG2UL_TYPE2_DEV

config SYS_SOC
	default "rmobile"

config SYS_BOARD
	default "rzg2ul-dev"

config SYS_VENDOR
	default "renesas"

config SYS_CONFIG_NAME
	default "rzg2ul-dev"

endif

if TARGET_SMARC_RZG2UL

config SYS_SOC
	default "rmobile"

config SYS_BOARD
	default "rzg2ul-dev"

config SYS_VENDOR
	default "renesas"

config SYS_CONFIG_NAME
	default "smarc-rzg2ul"

endif
```

## board/renesas/rzv2l-dev/Kconfig
```kconfig
if TARGET_RZV2L_DEV

config SYS_SOC
	default "rmobile"

config SYS_BOARD
	default "rzv2l-dev"

config SYS_VENDOR
	default "renesas"

config SYS_CONFIG_NAME
	default "rzv2l-dev"

endif

if TARGET_SMARC_RZV2L

config SYS_SOC
	default "rmobile"

config SYS_BOARD
	default "rzv2l-dev"

config SYS_VENDOR
	default "renesas"

config SYS_CONFIG_NAME
	default "smarc-rzv2l"

endif
```

## conf/layer.conf
```bitbake
LAYERDEPENDS_rzg2 = "core"
LAYERDEPENDS_rzg2 = "core yocto yoctobsp openembedded-layer meta-python"

# We have a conf and classes directory, add to BBPATH
BBPATH .= ":${LAYERDIR}"

# We have recipes-* directories, add to BBFILES
BBFILES += "${LAYERDIR}/recipes-*/*/*.bb \
    ${LAYERDIR}/recipes-*/*.bb \
    ${LAYERDIR}/recipes-*/*.bbappend \
    ${LAYERDIR}/recipes-*/*/*/*.bb \
    ${LAYERDIR}/recipes-*/*/*/*.bbappend "

# We only include the recipes-qt if we are having the QT_LAYER in bbconfig layer.
QTDIR = "${LAYERDIR}/dynamic-layers/qt5-layer"
BBFILES += "${@'${QTDIR}/*/*.bb	${QTDIR}/*/*.bbappend' if ('${QT_LAYER}' == 'True') else ' '}"
BBMASK_append = " qtwebengine "

# The .bbappend and .bb files are included if the respective layer
# collection is available.
BBFILES += "${@' '.join('${LAYERDIR}/dynamic-layers/%s/*/*.bbappend' % layer \
               for layer in BBFILE_COLLECTIONS.split())}"
BBFILES += "${@' '.join('${LAYERDIR}/dynamic-layers/%s/*/*.bb' % layer \
               for layer in BBFILE_COLLECTIONS.split())}"

# We have recipes-debian sub-directories that contained CIP-Core packages, add to BBFILES based on config CIP_MODE
CIPDIR = "${LAYERDIR}/recipes-common/recipes-debian"
BBFILES += "${@'${CIPDIR}/buster/*/*.bb	${CIPDIR}/buster/*/*.bbappend' if ('${CIP_MODE}' == 'Buster') else ' '}"
BBFILES += "${@'${CIPDIR}/bullseye/*/*.bb ${CIPDIR}/bullseye/*/*.bbappend' if ('${CIP_MODE}' == 'Bullseye') else ' '}"

BBFILE_COLLECTIONS += "rzg2"
BBFILE_PATTERN_rzg2 = "^${LAYERDIR}/"
BBFILE_PRIORITY_rzg2 = "15"
LAYERSERIES_COMPAT_rzg2 = "dunfell"

HOSTTOOLS += "xz"
```

## conf/machine/ek874.conf
```bitbake
#@TYPE: Machine
#@NAME: EK874 machine
#@DESCRIPTION: Machine configuration for running EK874

SOC_FAMILY = "r8a774c0"

DEFAULTTUNE ?= "cortexa53"
require conf/machine/include/tune-cortexa53.inc
require conf/machine/include/${SOC_FAMILY}.inc
require conf/machine/include/cip-core.inc
require conf/machine/include/rzg2h-common.inc

# Configuration for kernel
PREFERRED_PROVIDER_virtual/kernel = "linux-renesas"
# Device tree for RZG2E
KERNEL_DEVICETREE = " \
    renesas/r8a774c0-ek874.dtb \
    renesas/r8a774c0-cat874.dtb \
    renesas/r8a774c0-ek874-idk-2121wr.dtb \
    renesas/r8a774c0-ek874-mipi-2.1.dtb \
    renesas/r8a774c0-ek874-mipi-2.4.dtb \
    renesas/r8a774c0-ek874-revc.dtb \
    renesas/r8a774c0-cat874-revc.dtb \
    renesas/r8a774c0-ek874-revc-idk-2121wr.dtb \
    renesas/r8a774c0-ek874-revc-mipi-2.1.dtb \
    renesas/r8a774c0-ek874-revc-mipi-2.4.dtb \
    renesas/r8a774c0-es10-ek874.dtb \
    renesas/r8a774c0-es10-cat874.dtb \
    renesas/r8a774c0-es10-ek874-idk-2121wr.dtb \
    renesas/r8a774c0-es10-ek874-mipi-2.1.dtb \
    renesas/r8a774c0-es10-ek874-mipi-2.4.dtb \
"

# G2E u-boot configure
UBOOT_CONFIG ??= "ek874"
UBOOT_CONFIG[ek874] = "silinux_ek874_defconfig"

# flash write
EXTRA_IMAGEDEPENDS += " flash-writer"

# Command using to build kernel-module-gles
HOSTTOOLS += "sync"
```

## conf/machine/hihope-rzg2h.conf
```bitbake
#@TYPE: Machine
#@NAME: hihope-rzg2h machine
#@DESCRIPTION: Hoperun Technology HiHope RZ/G2H platform (hihope-rzg2h)

SOC_FAMILY = "r8a774e1"

DEFAULTTUNE ?= "cortexa57-cortexa53"
TUNE_CONF ?= "conf/machine/include/tune-cortexa57-cortexa53.inc"
require conf/machine/include/${SOC_FAMILY}.inc
require conf/machine/include/cip-core.inc
require conf/machine/include/rzg2h-common.inc
require ${TUNE_CONF}

# Configuration for kernel
PREFERRED_PROVIDER_virtual/kernel = "linux-renesas"
# Device tree for RZG2H
KERNEL_DEVICETREE = " \
    renesas/r8a774e1-hihope-rzg2h.dtb \
    renesas/r8a774e1-hihope-rzg2h-ex.dtb \
    renesas/r8a774e1-hihope-rzg2h-ex-mipi-2.1.dtb \
    renesas/r8a774e1-hihope-rzg2h-ex-mipi-2.4.dtb \
    renesas/r8a774e1-hihope-rzg2h-ex-idk-1110wr.dtb \
"

# G2H u-boot configure
UBOOT_CONFIG ??= "hihope-rzg2h"
UBOOT_CONFIG[hihope-rzg2h] = "hihope_rzg2_defconfig"

# flash writer
EXTRA_IMAGEDEPENDS += " flash-writer"

# Add variable to Build Configuration in build log
BUILDCFG_VARS_append = " SOC_FAMILY"

# Command using to build kernel-module-gles
HOSTTOOLS += "sync"
```

## conf/machine/include/cip-core.inc
```bitbake
DEBIAN_BASED = "${@bb.utils.contains('CIP_CORE', '1', 'debian', 'non_debian', d)}"
#DEBIAN_BASED = "non_debian" 
OVERRIDES .= ":${DEBIAN_BASED}"

BBMASK_non_debian += " recipes-debian"

BBMASK_debian += " perl_debian"

# Select gcc,gdb, python3 debian version
GCCVERSION_debian = "8.3.0"
SDKGCCVERSION_debian = "${GCCVERSION}"

GLIBCVERSION_debian = "2.28%"
PREFERRED_VERSION_glibc_debian = "${GLIBCVERSION}"
PREFERRED_VERSION_nativesdk-glibc_debian = "${GLIBCVERSION}"
PREFERRED_VERSION_nativesdk-glibc-locale_debian = "${GLIBCVERSION}" 

BINUVERSION_debian = "2.31.%"
PREFERRED_VERSION_nativesdk-binutils_debian = "${BINUVERSION}"

PREFERRED_VERSION_gdb_debian = "8.1"

PREFERRED_VERSION_busybox_debian = "1.31.%"

RDEPENDS_xz_append_debian = "bash"
RDEPENDS_gzip_append_debian = "bash"
RDEPENDS_adduser_append_debian = "perl"
```

## conf/machine/include/r8a774b1.inc
```bitbake
SOC_FAMILY =. "rzg2h:"
require conf/machine/include/soc-family.inc
LINUXLIBCVERSION = "5.10%"
```

## conf/machine/include/r8a774c0.inc
```bitbake
SOC_FAMILY =. "rzg2:"
require conf/machine/include/soc-family.inc
LINUXLIBCVERSION = "5.10%"
```

## conf/machine/include/r9a07g044c.inc
```bitbake
SOC_FAMILY =. "rzg2lc:"
require conf/machine/include/soc-family.inc
LINUXLIBCVERSION = "5.10%"
```

## conf/machine/include/r9a07g044l.inc
```bitbake
SOC_FAMILY =. "rzg2l:"
require conf/machine/include/soc-family.inc
LINUXLIBCVERSION = "4.19%"
```

## conf/machine/include/r9a09g055ma3gbg.inc
```bitbake
SOC_FAMILY =. "rzv2ma:"
require conf/machine/include/soc-family.inc
LINUXLIBCVERSION = "5.10%"
```

## conf/machine/include/rzfive-common.inc
```bitbake
require conf/machine/include/${SOC_FAMILY}.inc

MACHINEOVERRIDES =. "rzfive:"

BBMASK_append = " recipes-rzg2h|recipes-rzv2l|recipes-rzg2l"

MACHINE_FEATURES = ""

KERNEL_IMAGETYPE = "Image"
IMAGE_FSTYPES_append = " tar.bz2 ext4"

SERIAL_CONSOLES = "115200;ttySC0"

# Configuration for OPENSBI
EXTRA_IMAGEDEPENDS += " opensbi"

# Add variable to Build Configuration in build log
BUILDCFG_VARS_append = " SOC_FAMILY"

# We must disable ptest when can not use GPLv3 License,
# ptest require many package, which have GPLv3 License,
DISTRO_FEATURES_remove += "${@bb.utils.contains("INCOMPATIBLE_LICENSE", "GPLv3", "ptest", "",d)}"

# Match version between native and target sysroot in meta-gplv2 when not using GPLv3.
PREFERRED_VERSION_gdbm-native ?= "${@bb.utils.contains("INCOMPATIBLE_LICENSE", "GPLv3", "1.8.3", "",d)}"

# u-boot
PREFERRED_VERSION_u-boot = "v2020.10%"
EXTRA_IMAGEDEPENDS += " u-boot"

PACKAGE_INSTALL_remove += " optee-client v4l2-init "
```

## conf/machine/include/rzg2-common.inc
```bitbake
EXT_GFX_BACKEND = "${@oe.utils.ifelse((d.getVar('RZ_FEATURE') == 'True') and (d.getVar('USE_RENESAS_GLES') == '1'), '1', '0')}"

# 32BIT package install (default is disable)
# This variables can be used only in multilib.
USE_32BIT_PKGS ?= "0"
USE_32BIT_WAYLAND ?= "0"
USE_32BIT_MMP ?= "0"

MACHINE_FEATURES = ""

KERNEL_IMAGETYPE = "Image"
IMAGE_FSTYPES_append = " tar.bz2 ext4"

SERIAL_CONSOLES = "115200;ttySC0"

# Configuration for ARM Trusted Firmware
#EXTRA_IMAGEDEPENDS += " trusted-firmware-a"

# Add variable to Build Configuration in build log
BUILDCFG_VARS_append = " SOC_FAMILY"

# We must disable ptest when can not use GPLv3 License,
# ptest require many package, which have GPLv3 License,
DISTRO_FEATURES_remove += "${@bb.utils.contains("INCOMPATIBLE_LICENSE", "GPLv3", "ptest", "",d)}"

# Match version between native and target sysroot in meta-gplv2 when not using GPLv3.
PREFERRED_VERSION_gdbm-native ?= "${@bb.utils.contains("INCOMPATIBLE_LICENSE", "GPLv3", "1.8.3", "",d)}"

# u-boot
PREFERRED_VERSION_u-boot = "v2021.10%"
EXTRA_IMAGEDEPENDS += " u-boot"
```

## conf/machine/include/rzg2h-common.inc
```bitbake
require rzg2-common.inc
require include/ecc-control.inc

# Configuration for ARM Trusted Firmware
#EXTRA_IMAGEDEPENDS += " optee-os"

MACHINEOVERRIDES =. "rzg2h:"

BBMASK_append = " recipes-rzg2l"
```

## conf/machine/include/rzg2l-common.inc
```bitbake
require conf/machine/include/${SOC_FAMILY}.inc
require rzg2-common.inc

# Firmware-pack 
EXTRA_IMAGEDEPENDS += " firmware-pack"

MACHINEOVERRIDES =. "rzg2l:"

BBMASK_append = " recipes-rzg2h"

# u-boot
PREFERRED_VERSION_u-boot = "v2020.10%"
EXTRA_IMAGEDEPENDS += " u-boot"
```

## conf/machine/include/rzv2l-common.inc
```bitbake
require conf/machine/include/${SOC_FAMILY}.inc
require rzg2-common.inc

# Firmware-pack
EXTRA_IMAGEDEPENDS += " firmware-pack"

MACHINEOVERRIDES =. "rzg2l:"

BBMASK_append = " recipes-rzg2h"
```

## conf/machine/include/rzv2ma-common.inc
```bitbake
require rzg2-common.inc
require include/ecc-control.inc

# Configuration for ARM Trusted Firmware
#EXTRA_IMAGEDEPENDS += " optee-os"

MACHINEOVERRIDES =. "rzv2ma:"

BBMASK_append = " recipes-rzv2l"
BBMASK_append += "/meta-renesas/recipes-rzv2m/"
```

## conf/machine/rzg2l-dev.conf
```bitbake
#@TYPE: Machine
#@NAME: rzg2l-dev machine
#@DESCRIPTION: RZ/G2L EVK DEV platform

SOC_FAMILY = "r9a07g044l"
require conf/machine/include/rzg2l-common.inc
require conf/machine/include/cip-core.inc

DEFAULTTUNE ?= "cortexa55"

TUNE_CONF ?= "conf/machine/include/tune-cortexa55.inc"
require ${TUNE_CONF}

PREFERRED_PROVIDER_virtual/kernel="linux-renesas"

UBOOT_CONFIG ??= "rzg2l-dev"
UBOOT_CONFIG[rzg2l-dev] = "rzg2l-dev_defconfig"

# flash writer
EXTRA_IMAGEDEPENDS += " flash-writer"

# Supported devicetree
KERNEL_DEVICETREE = " \
	renesas/r9a07g044l2-dev.dtb \
"
```

## conf/machine/rzg2ul-dev.conf
```bitbake
#@TYPE: Machine
#@NAME: rzg2ul-dev machine
#@DESCRIPTION: RZ/G2UL EVK  DEV platform

SOC_FAMILY = "r9a07g043u"
require conf/machine/include/rzg2l-common.inc
require conf/machine/include/cip-core.inc

DEFAULTTUNE ?= "cortexa55"

TUNE_CONF ?= "conf/machine/include/tune-cortexa55.inc"
require ${TUNE_CONF}

PREFERRED_PROVIDER_virtual/kernel="linux-renesas"

UBOOT_CONFIG ??= "rzg2ul-dev"
UBOOT_CONFIG[rzg2ul-dev] = "rzg2ul-type1-dev_defconfig"

# flash writer
EXTRA_IMAGEDEPENDS += " flash-writer"

# Supported devicetree
KERNEL_DEVICETREE = " \
	renesas/r9a07g043u11-dev.dtb \
"
```

## conf/machine/rzv2m.conf
```bitbake
#@TYPE: Machine
#@NAME: RZV2M machine
#@DESCRIPTION: Machine configuration for running RZV2M

SOC_FAMILY = "r9a09g011gbg"

DEFAULTTUNE ?= "cortexa53"
require conf/machine/include/tune-cortexa53.inc
require conf/machine/include/${SOC_FAMILY}.inc
require conf/machine/include/cip-core.inc
require conf/machine/include/rzv2m-common.inc

# Configuration for kernel
PREFERRED_PROVIDER_virtual/kernel = "linux-renesas"
# Device tree for RZG2E
KERNEL_DEVICETREE = " \
    renesas/r9a09g011gbg-evaluation-board.dtb \
"

# bootloader
EXTRA_IMAGEDEPENDS += " bootloader"

# V2M u-boot configure
UBOOT_CONFIG ??= "rzv2m"
UBOOT_CONFIG[rzv2m] = "r9a09g011gbg_rzv2m_defconfig"

# Command using to build kernel-module-gles
HOSTTOOLS += "sync"
```

## conf/machine/rzv2ma.conf
```bitbake
#@TYPE: Machine
#@NAME: RZV2MA machine
#@DESCRIPTION: Machine configuration for running RZV2MA

SOC_FAMILY = "r9a09g055ma3gbg"

DEFAULTTUNE ?= "cortexa53"
require conf/machine/include/tune-cortexa53.inc
require conf/machine/include/${SOC_FAMILY}.inc
require conf/machine/include/cip-core.inc
require conf/machine/include/rzv2ma-common.inc

# Configuration for kernel
PREFERRED_PROVIDER_virtual/kernel = "linux-renesas"
# Device tree for RZV2MA
KERNEL_DEVICETREE = " \
    renesas/r9a09g055ma3gbg-evaluation-board.dtb \
"

# bootloader
EXTRA_IMAGEDEPENDS += " bootloader"

# V2M u-boot configure
UBOOT_CONFIG ??= "rzv2ma"
UBOOT_CONFIG[rzv2ma] = "r9a09g055ma3gbg_rzv2ma_defconfig"

# Command using to build kernel-module-gles
HOSTTOOLS += "sync"
```
